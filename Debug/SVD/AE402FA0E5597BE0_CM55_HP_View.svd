# AE402FA0E5597BE0_CM55_HP_View register map
Vendor: Alif Semiconductor; Series: E4; File version: 1.0
CPU: CM55 r1p0, selectable endian, MPU, FPU, double-precision FPU, DSP, VTOR, 8 interrupt priority bits, 1 SAU regions

## Further device data
features: package=WLCSP216 ioPins=136 sramSize=9.75 mramSize=5.5 ospiSize=256 securityType=Enclave gpuType=2D GPU displayType=24b Parallel + MIPI DSI cameraType=8-16b Parallel + MIPI CSI-2, ISP, JPEG temp=-20,85 adc12=3,12 adc24=1,24 dac=2,12 cmp=4 timer=12,32 qec=4,32 i2c=4 i2s=4 can=1 eth=1,100000000 ospi=2 sdio=1,8 spi=4,50000000 uart=8,2500000 usbotg=1
books:
  https://alifsemi.com/contact-us/ type=Datasheet title=Datasheet - Contact Alif representative
  https://alifsemi.com/contact-us/ type=Hardware Reference Manual title=HWRM - Contact Alif representative
  https://swrm.alifsemi.com type=SWRM title=Software Reference Manual
cpus:
  M55-HP core=Cortex-M55 revision=r1p0 endian=Configurable mpuPresent=true fpuPresent=true fpuDP=true dspPresent=true vtorPresent=true nvicPrioBits=8 vendorSystickConfig=false sauNumRegions=1 pmuPresent=true pmuNumEventCnt=8 mvePresent=true mveFP=true tzPresent=true cpuClock=400000000
  M55-HE core=Cortex-M55 revision=r1p0 endian=Configurable mpuPresent=true fpuPresent=true fpuDP=true dspPresent=true vtorPresent=true nvicPrioBits=8 vendorSystickConfig=false sauNumRegions=1 pmuPresent=true pmuNumEventCnt=8 mvePresent=true mveFP=true tzPresent=true cpuClock=160000000
memories:
  Utility_SRAM start=0x4902C000 size=0x00001000 access=rw default=1
  SRAM0 start=0x02000000 size=0x00400000 access=rw default=1
  SRAM1 start=0x02400000 size=0x00400000 access=rw default=1
  SRAM2 start=0x50000000 size=0x00040000 access=rw default=1
  SRAM3 start=0x50800000 size=0x00100000 access=rw default=1
  SRAM4 start=0x58000000 size=0x00040000 access=rw default=1
  SRAM5 start=0x58800000 size=0x00040000 access=rw default=1
  MRAM start=0x80000000 size=0x00580000 access=rx default=1
  HEXSPI0 start=0xA0000000 size=0x08000000 access=rw default=1
  HEXSPI1 start=0xC0000000 size=0x08000000 access=rw default=1
firewalls:
  FCTLR ProtectionExtension=PE.1 MonitorExtension=ME.0 TranslationExtension=TE.0 RegionSizeExtension=RSE.1 num_rgn=3 mnrs=4KB mxrs=2MB num_mpe=1 single_mst=0 location=Slave side protectedRegion=0x1A80_0000 - 0x1A8E_FFFF
  FC1 ProtectionExtension=PE.1 MonitorExtension=ME.0 TranslationExtension=TE.0 RegionSizeExtension=RSE.0 num_rgn=22 mnrs=4KB mxrs=512MB num_mpe=1 single_mst=0 location=Slave side protectedRegion=0x1000_0000 - 0x17FF_FFFF, 0x1B00_0000 - 0x1E0F_FFFF
  FC2 ProtectionExtension=PE.1 MonitorExtension=ME.0 TranslationExtension=TE.0 RegionSizeExtension=RSE.0 num_rgn=1 mnrs=4KB mxrs=512MB num_mpe=1 single_mst=0 location=Slave side protectedRegion=0x1800_0000 - 0x19FF_FFFF
  FC3 ProtectionExtension=PE.1 MonitorExtension=ME.0 TranslationExtension=TE.0 RegionSizeExtension=RSE.0 num_rgn=40 mnrs=4KB mxrs=8MB num_mpe=1 single_mst=0 location=Slave side protectedRegion=0x1A00_0000 - 0x1A60_FFFF
  FC4 ProtectionExtension=PE.2 MonitorExtension=ME.0 TranslationExtension=TE.0 RegionSizeExtension=RSE.1 num_rgn=32 mnrs=4KB mxrs=128MB num_mpe=4 single_mst=0 location=Slave side protectedRegion=0x0800_0000 - 0x0FFF_FFFF
  FC5 ProtectionExtension=PE.2 MonitorExtension=ME.0 TranslationExtension=TE.0 RegionSizeExtension=RSE.1 num_rgn=32 mnrs=256B mxrs=32MB num_mpe=4 single_mst=0 location=Slave side protectedRegion=0x0200_0000 - 0x03FF_FFFF
  FC7 ProtectionExtension=PE.2 MonitorExtension=ME.2 TranslationExtension=TE.2 RegionSizeExtension=RSE.1 num_rgn=16 mnrs=4KB mxrs=4GB num_mpe=1 single_mst=1 location=Master side protectedRegion=M55-HP address map (0x0000_0000 - 0xFFFF_FFFF)
  FC8 ProtectionExtension=PE.2 MonitorExtension=ME.2 TranslationExtension=TE.2 RegionSizeExtension=RSE.1 num_rgn=16 mnrs=4KB mxrs=4GB num_mpe=1 single_mst=1 location=Master side protectedRegion=M55-HE address map (0x0000_0000 - 0xFFFF_FFFF)
  FC9 ProtectionExtension=PE.2 MonitorExtension=ME.2 TranslationExtension=TE.2 RegionSizeExtension=RSE.1 num_rgn=32 mnrs=4KB mxrs=4GB num_mpe=4 single_mst=0 location=Master side protectedRegion=Reserved
  FC10 ProtectionExtension=PE.2 MonitorExtension=ME.2 TranslationExtension=TE.2 RegionSizeExtension=RSE.1 num_rgn=8 mnrs=4KB mxrs=4GB num_mpe=4 single_mst=0 location=Master side protectedRegion=Reserved
  FC11 ProtectionExtension=PE.2 MonitorExtension=ME.0 TranslationExtension=TE.0 RegionSizeExtension=RSE.1 num_rgn=32 mnrs=256B mxrs=512MB num_mpe=4 single_mst=0 location=Slave side protectedRegion=0x4000_0000 - 0x5FFF_FFFF
  FC13 ProtectionExtension=PE.2 MonitorExtension=ME.0 TranslationExtension=TE.0 RegionSizeExtension=RSE.1 num_rgn=32 mnrs=4KB mxrs=2GB num_mpe=4 single_mst=0 location=Slave side protectedRegion=0x8000_0000 - 0xDFFF_FFFF
  FC14 ProtectionExtension=PE.2 MonitorExtension=ME.2 TranslationExtension=TE.2 RegionSizeExtension=RSE.1 num_rgn=8 mnrs=4KB mxrs=4GB num_mpe=2 single_mst=0 location=Master side protectedRegion=Reserved
pins:
  P0_0 location=AA2 register=P0_0 offset=0x0 muxModes=GPIO0_0, OSPI0_D0_A, UART0_RX_A, I3C_SDA_A, UT0_T0_A, LPCAM_HSYNC_B, CAM_HSYNC_A, ANA_S0
  P0_1 location=L8 register=P0_1 offset=0x4 muxModes=GPIO0_1, OSPI0_D1_A, UART0_TX_A, I3C_SCL_A, UT0_T1_A, LPCAM_VSYNC_B, CAM_VSYNC_A, ANA_S1
  P0_2 location=J8 register=P0_2 offset=0x8 muxModes=GPIO0_2, OSPI0_D2_A, UART0_CTS_A, I2C0_SDA_A, UT1_T0_A, LPCAM_PCLK_B, CAM_PCLK_A, ANA_S2
  P0_3 location=P7 register=P0_3 offset=0xC muxModes=GPIO0_3, OSPI0_D3_A, UART0_RTS_A, I2C0_SCL_A, UT1_T1_A, LPCAM_XVCLK_B, CAM_XVCLK_A, ANA_S3
  P0_4 location=T5 register=P0_4 offset=0x10 muxModes=GPIO0_4, OSPI0_D4_A, UART1_RX_A, PDM_D0_A, I2C1_SDA_A, UT2_T0_A, CAN_RXD_B, ANA_S4
  P0_5 location=T3 register=P0_5 offset=0x14 muxModes=GPIO0_5, OSPI0_D5_A, UART1_TX_A, PDM_C0_A, I2C1_SCL_A, UT2_T1_A, CAN_TXD_B, ANA_S5
  P0_6 location=U2 register=P0_6 offset=0x18 muxModes=GPIO0_6, OSPI0_D6_A, UART1_CTS_A, PDM_D1_A, I2C2_SCL_A, UT3_T0_A, CAN_STBY_B, ANA_S6
  P0_7 location=T1 register=P0_7 offset=0x1C muxModes=GPIO0_7, OSPI0_D7_A, UART1_RTS_A, PDM_C1_A, I2C2_SDA_A, UT3_T1_A, CDC_DE_B, ANA_S7
  P1_0 location=R4 register=P1_0 offset=0x20 muxModes=GPIO1_0, UART2_RX_A, SPI0_MISO_A, I2C3_SDA_A, UT4_T0_A, LPCAM_HSYNC_C, ETH_RXD0_C, ANA_S8
  P1_1 location=P5 register=P1_1 offset=0x24 muxModes=GPIO1_1, UART2_TX_A, SPI0_MOSI_A, I2C3_SCL_A, UT4_T1_A, LPCAM_VSYNC_C, ETH_RXD1_C, ANA_S9
  P1_2 location=N6 register=P1_2 offset=0x28 muxModes=GPIO1_2, UART3_RX_A, SPI0_SCLK_A, I3C_SDA_B, UT5_T0_A, LPCAM_PCLK_C, ETH_RST_C, ANA_S10
  P1_3 location=M7 register=P1_3 offset=0x2C muxModes=GPIO1_3, UART3_TX_A, SPI0_SS0_A, I3C_SCL_B, UT5_T1_A, LPCAM_XVCLK_C, ETH_TXD0_C, ANA_S11
  P1_4 location=P1 register=P1_4 offset=0x30 muxModes=GPIO1_4, OSPI0_SS0_A, UART0_RX_B, SPI0_SS1_A, UT6_T0_A, LPCAM_D0_C, ETH_TXD1_C, ANA_S12
  P1_5 location=R2 register=P1_5 offset=0x34 muxModes=GPIO1_5, OSPI0_SS1_A, UART0_TX_B, SPI0_SS2_A, UT6_T1_A, LPCAM_D1_C, ETH_TXEN_C, ANA_S13
  P1_6 location=P3 register=P1_6 offset=0x38 muxModes=GPIO1_6, OSPI0_RXDS0_B, UART1_RX_B, I2S0_SDI_A, UT7_T0_A, LPCAM_D2_C, ETH_IRQ_C, ANA_S14
  P1_7 location=N4 register=P1_7 offset=0x3C muxModes=GPIO1_7, OSPI0_SCLK_A, UART1_TX_B, I2S0_SDO_A, UT7_T1_A, LPCAM_D3_C, ETH_REFCLK_C, ANA_S15
  P2_0 location=M1 register=P2_0 offset=0x40 muxModes=GPIO2_0, OSPI0_D0_B, UART2_RX_B, LPPDM_D0_A, UT8_T0_A, LPCAM_D4_C, ETH_MDIO_C, ANA_S16
  P2_1 location=N2 register=P2_1 offset=0x44 muxModes=GPIO2_1, OSPI0_D1_B, UART2_TX_B, LPPDM_C0_A, UT8_T1_A, LPCAM_D5_C, ETH_MDC_C, ANA_S17
  P2_2 location=M3 register=P2_2 offset=0x48 muxModes=GPIO2_2, OSPI0_D2_B, UART3_RX_B, LPPDM_D1_A, UT9_T0_A, LPCAM_D6_C, ETH_CRS_DV_C, ANA_S18
  P2_3 location=M5 register=P2_3 offset=0x4C muxModes=GPIO2_3, OSPI0_D3_B, UART3_TX_B, LPPDM_C1_A, UT9_T1_A, LPCAM_D7_C, CDC_PCLK_B, ANA_S19
  P2_4 location=L4 register=P2_4 offset=0x50 muxModes=GPIO2_4, OSPI0_D4_B, LPI2S_SDI_A, SPI1_MISO_A, UT10_T0_A, LPCAM_D0_B, CAM_D0_A, ANA_S20
  P2_5 location=K1 register=P2_5 offset=0x54 muxModes=GPIO2_5, OSPI0_D5_B, LPI2S_SDO_A, SPI1_MOSI_A, UT10_T1_A, LPCAM_D1_B, CAM_D1_A, ANA_S21
  P2_6 location=L2 register=P2_6 offset=0x58 muxModes=GPIO2_6, OSPI0_D6_B, LPI2S_SCLK_A, SPI1_SCLK_A, UT11_T0_A, LPCAM_D2_B, CAM_D2_A, ANA_S22
  P2_7 location=L6 register=P2_7 offset=0x5C muxModes=GPIO2_7, OSPI0_D7_B, LPI2S_WS_A, SPI1_SS0_A, UT11_T1_A, LPCAM_D3_B, CAM_D3_A, ANA_S23
  P3_0 location=J12 register=P3_0 offset=0x60 muxModes=GPIO3_0, OSPI0_SCLK_B, UART4_RX_A, PDM_D0_B, I2S0_SCLK_A, QEC0_X_A, LPCAM_D4_B, CAM_D4_A
  P3_1 location=L12 register=P3_1 offset=0x64 muxModes=GPIO3_1, OSPI0_SCLKN_B, UART4_TX_A, PDM_C0_B, I2S0_WS_A, QEC0_Y_A, LPCAM_D5_B, CAM_D5_A
  P3_2 location=D17 register=P3_2 offset=0x68 muxModes=GPIO3_2, OSPI0_SS0_B, PDM_D1_B, I2S1_SDI_A, I3C_SDA_C, QEC0_Z_A, LPCAM_D6_B, CAM_D6_A
  P3_3 location=C18 register=P3_3 offset=0x6C muxModes=GPIO3_3, OSPI0_SS1_B, PDM_C1_B, I2S1_SDO_A, I3C_SCL_C, QEC1_X_A, LPCAM_D7_B, CAM_D7_A
  P3_4 location=E14 register=P3_4 offset=0x70 muxModes=GPIO3_4, OSPI0_RXDS0_A, UART5_RX_A, LPPDM_C0_B, I2S1_SCLK_A, I2C0_SCL_B, QEC1_Y_A, CAM_D8_A
  P3_5 location=F13 register=P3_5 offset=0x74 muxModes=GPIO3_5, OSPI0_SCLKN_A, UART5_TX_A, LPPDM_D0_B, SPI0_SS1_B, I2C0_SDA_B, QEC1_Z_A, CAM_D9_A
  P3_6 location=AA16 register=P3_6 offset=0x78 muxModes=GPIO3_6, HFXO_OUT_A, LPUART_CTS_B, LPPDM_C1_B, SPI0_SS2_B, I2C1_SDA_B, QEC2_X_A, CAM_D10_A
  P3_7 location=Y15 register=P3_7 offset=0x7C muxModes=GPIO3_7, JTAG_TRACECLK, LPUART_RTS_B, LPPDM_D1_B, SPI1_SS1_A, I2C1_SCL_B, QEC2_Y_A, CAM_D11_A
  P4_0 location=F3 register=P4_0 offset=0x80 muxModes=GPIO4_0, JTAG_TDATA0, APLL_OUT_A, I2S1_WS_A, SPI1_SS2_A, QEC2_Z_A, CDC_VSYNC_B, CAM_D12_A
  P4_1 location=C2 register=P4_1 offset=0x84 muxModes=GPIO4_1, JTAG_TDATA1, I2S0_SDI_B, SPI1_SS3_A, QEC3_X_A, SD_CLK_D, CDC_HSYNC_B, CAM_D13_A
  P4_2 location=D3 register=P4_2 offset=0x88 muxModes=GPIO4_2, JTAG_TDATA2, LPI2C1_SDA_A, I2S0_SDO_B, SPI2_MISO_A, QEC3_Y_A, SD_CMD_D, CAM_D14_A
  P4_3 location=A2 register=P4_3 offset=0x8C muxModes=GPIO4_3, JTAG_TDATA3, LPI2C1_SCL_A, I2S0_SCLK_B, SPI2_MOSI_A, QEC3_Z_A, SD_RST_D, CAM_D15_A
  P4_4 location=G6 register=P4_4 offset=0x90 muxModes=GPIO4_4, JTAG_TCK, I2S0_WS_B, SPI2_SCLK_A, FAULT0_A
  P4_5 location=K7 register=P4_5 offset=0x94 muxModes=GPIO4_5, JTAG_TMS, SPI2_SS0_A, FAULT1_A
  P4_6 location=H7 register=P4_6 offset=0x98 muxModes=GPIO4_6, JTAG_TDI, SPI2_SS1_A, FAULT2_A
  P4_7 location=B3 register=P4_7 offset=0x9C muxModes=GPIO4_7, JTAG_TDO, SPI2_SS2_A, FAULT3_A
  P5_0 location=C4 register=P5_0 offset=0xA0 muxModes=GPIO5_0, OSPI1_RXDS0_A, UART4_RX_C, PDM_D2_A, SPI0_MISO_B, I2C2_SDA_B, UT0_T0_B, SD_D0_A
  P5_1 location=G8 register=P5_1 offset=0xA4 muxModes=GPIO5_1, OSPI1_SS0_A, UART4_TX_C, PDM_D3_A, SPI0_MOSI_B, I2C2_SCL_B, UT0_T1_B, SD_D1_A
  P5_2 location=B5 register=P5_2 offset=0xA8 muxModes=GPIO5_2, OSPI1_SCLKN_A, UART5_RX_C, PDM_C3_A, SPI0_SS0_B, LPI2C0_SCL_B, UT1_T0_B, SD_D2_A
  P5_3 location=F7 register=P5_3 offset=0xAC muxModes=GPIO5_3, OSPI1_SCLK_A, UART5_TX_C, SPI0_SCLK_B, LPI2C0_SDA_B, UT1_T1_B, SD_D3_A, CDC_PCLK_A
  P5_4 location=C6 register=P5_4 offset=0xB0 muxModes=GPIO5_4, OSPI1_SS1_A, UART3_CTS_A, PDM_D2_B, SPI0_SS3_A, UT2_T0_B, SD_D4_A, CDC_DE_A
  P5_5 location=A6 register=P5_5 offset=0xB4 muxModes=GPIO5_5, OSPI1_SCLK_C, UART3_RTS_A, PDM_D3_B, UT2_T1_B, SD_D5_A, ETH_RXD0_A, CDC_HSYNC_A
  P5_6 location=D7 register=P5_6 offset=0xB8 muxModes=GPIO5_6, UART1_CTS_B, I2C2_SCL_C, UT3_T0_B, SD_D6_A, ETH_RXD1_A, CDC_VSYNC_A
  P5_7 location=B7 register=P5_7 offset=0xBC muxModes=GPIO5_7, OSPI1_SS0_C, UART1_RTS_B, I2C2_SDA_C, UT3_T1_B, SD_D7_A, ETH_RST_A
  P6_0 location=E8 register=P6_0 offset=0xC0 muxModes=GPIO6_0, OSPI0_D0_C, UART4_DE_A, PDM_D0_C, UT4_T0_B, SD_D0_D, ETH_TXD0_A, LPSPI_SS1_A
  P6_1 location=H9 register=P6_1 offset=0xC4 muxModes=GPIO6_1, OSPI0_D1_C, UART5_DE_A, PDM_C0_C, UT4_T1_B, SD_D1_D, ETH_TXD1_A, LPSPI_SS2_A
  P6_2 location=C8 register=P6_2 offset=0xC8 muxModes=GPIO6_2, OSPI0_D2_C, UART2_CTS_A, LPI3C_SDA_A, PDM_D1_C, UT5_T0_B, SD_D2_D, ETH_TXEN_A
  P6_3 location=F9 register=P6_3 offset=0xCC muxModes=GPIO6_3, OSPI0_D3_C, UART2_RTS_A, LPI3C_SCL_A, PDM_C1_C, UT5_T1_B, SD_D3_D, ETH_IRQ_A
  P6_4 location=G10 register=P6_4 offset=0xD0 muxModes=GPIO6_4, OSPI0_D4_C, UART2_CTS_B, LFRC_OUT_A, SPI1_SS0_B, UT6_T0_B, SD_D4_D, ETH_REFCLK_A
  P6_5 location=E10 register=P6_5 offset=0xD4 muxModes=GPIO6_5, OSPI0_D5_C, UART2_RTS_B, LPI2C1_SDA_B, SPI1_SS1_B, UT6_T1_B, SD_D5_D, ETH_MDIO_A
  P6_6 location=C10 register=P6_6 offset=0xD8 muxModes=GPIO6_6, OSPI0_D6_C, UART0_CTS_B, LPI2C1_SCL_B, SPI1_SS2_B, UT7_T0_B, SD_D6_D, ETH_MDC_A
  P6_7 location=D11 register=P6_7 offset=0xDC muxModes=GPIO6_7, OSPI0_D7_C, UART0_RTS_B, PDM_C2_A, SPI1_SS3_B, UT7_T1_B, SD_D7_D, ETH_CRS_DV_A
  P7_0 location=A12 register=P7_0 offset=0xE0 muxModes=GPIO7_0, LPUT0_T0_A, CMP3_OUT_A, SPI0_MISO_C, I2C0_SDA_C, UT8_T0_B, SD_CMD_A, CAN_RXD_A
  P7_1 location=C12 register=P7_1 offset=0xE4 muxModes=GPIO7_1, LPUT0_T1_A, CMP2_OUT_A, SPI0_MOSI_C, I2C0_SCL_C, UT8_T1_B, SD_CLK_A, CAN_TXD_A
  P7_2 location=K11 register=P7_2 offset=0xE8 muxModes=GPIO7_2, LPUT1_T0_A, UART3_CTS_B, CMP1_OUT_A, SPI0_SCLK_C, I2C1_SDA_C, UT9_T0_B, SD_RST_A
  P7_3 location=E12 register=P7_3 offset=0xEC muxModes=GPIO7_3, LPUT1_T1_A, UART3_RTS_B, CMP0_OUT_A, SPI0_SS0_C, I2C1_SCL_C, UT9_T1_B, CAN_STBY_A
  P7_4 location=U16 register=P7_4 offset=0xF0 muxModes=GPIO7_4, LPUT2_T0_A, LPUART_CTS_A, LPPDM_C2_A, LPSPI_MISO_A, LPI2C0_SCL_A, UT10_T0_B
  P7_5 location=U14 register=P7_5 offset=0xF4 muxModes=GPIO7_5, LPUT2_T1_A, LPUART_RTS_A, LFXO_OUT_A, LPPDM_D2_A, LPSPI_MOSI_A, LPI2C0_SDA_A, UT10_T1_B
  P7_6 location=V17 register=P7_6 offset=0xF8 muxModes=GPIO7_6, LPI2C1_SDA_C, LPUART_RX_A, LPI3C_SDA_B, LPPDM_C3_A, LPSPI_SCLK_A, I3C_SDA_D, UT11_T0_B
  P7_7 location=W18 register=P7_7 offset=0xFC muxModes=GPIO7_7, LPI2C1_SCL_C, LPUART_TX_A, LPI3C_SCL_B, LPPDM_D3_A, LPSPI_SS0_A, I3C_SCL_D, UT11_T1_B
  P8_0 location=B13 register=P8_0 offset=0x100 muxModes=GPIO8_0, OSPI1_SCLKN_C, AUDIO_CLK_A, FAULT0_B, LPCAM_D0_A, SD_D0_C, CDC_D0_A, CAM_D0_B
  P8_1 location=D13 register=P8_1 offset=0x104 muxModes=GPIO8_1, I2S2_SDI_A, FAULT1_B, LPCAM_D1_A, SD_D1_C, CDC_D1_A, CAM_D1_B, OSPI1_SS1_C
  P8_2 location=A14 register=P8_2 offset=0x108 muxModes=GPIO8_2, I2S2_SDO_A, SPI0_SS3_B, FAULT2_B, LPCAM_D2_A, SD_D2_C, CDC_D2_A, CAM_D2_B
  P8_3 location=C14 register=P8_3 offset=0x10C muxModes=GPIO8_3, I2S2_SCLK_A, SPI1_MISO_B, FAULT3_B, LPCAM_D3_A, SD_D3_C, CDC_D3_A, CAM_D3_B
  P8_4 location=G12 register=P8_4 offset=0x110 muxModes=GPIO8_4, I2S2_WS_A, SPI1_MOSI_B, QEC0_X_B, LPCAM_D4_A, SD_D4_C, CDC_D4_A, CAM_D4_B
  P8_5 location=G16 register=P8_5 offset=0x114 muxModes=GPIO8_5, OSPI0_RXDS1_A, SPI1_SCLK_B, QEC0_Y_B, LPCAM_D5_A, SD_D5_C, CDC_D5_A, CAM_D5_B
  P8_6 location=H13 register=P8_6 offset=0x118 muxModes=GPIO8_6, OSPI1_RXDS1_B, I2S3_SCLK_B, QEC0_Z_B, LPCAM_D6_A, SD_D6_C, CDC_D6_A, CAM_D6_B
  P8_7 location=G18 register=P8_7 offset=0x11C muxModes=GPIO8_7, OSPI0_RXDS1_C, I2S3_WS_B, QEC1_X_B, LPCAM_D7_A, SD_D7_C, CDC_D7_A, CAM_D7_B
  P9_0 location=H15 register=P9_0 offset=0x120 muxModes=GPIO9_0, OSPI1_RXDS1_C, I2S3_SDI_B, QEC1_Y_B, SD_CMD_C, CDC_D8_A, CAM_D8_B, LPSPI_SS3_A
  P9_1 location=H17 register=P9_1 offset=0x124 muxModes=GPIO9_1, LPUART_RX_B, I2S3_SDO_B, QEC1_Z_B, SD_CLK_C, CDC_D9_A, CAM_D9_B, LPSPI_SS4_A
  P9_2 location=J14 register=P9_2 offset=0x128 muxModes=GPIO9_2, LPUART_TX_B, I2S3_SDI_A, SPI2_MISO_B, QEC2_X_B, SD_RST_C, CDC_D10_A, CAM_D10_B
  P9_3 location=K13 register=P9_3 offset=0x12C muxModes=GPIO9_3, HFXO_OUT_B, UART7_RX_B, I2S3_SDO_A, SPI2_MOSI_B, QEC2_Y_B, CDC_D11_A, CAM_D11_B
  P9_4 location=J18 register=P9_4 offset=0x130 muxModes=GPIO9_4, UART7_TX_B, I2S3_SCLK_A, SPI2_SCLK_B, I2C3_SDA_C, QEC2_Z_B, CDC_D12_A, CAM_D12_B
  P9_5 location=J16 register=P9_5 offset=0x134 muxModes=GPIO9_5, OSPI1_D0_C, I2S3_WS_A, SPI2_SS0_B, I2C3_SCL_C, QEC3_X_B, CDC_D13_A, CAM_D13_B
  P9_6 location=K17 register=P9_6 offset=0x138 muxModes=GPIO9_6, OSPI1_D1_C, AUDIO_CLK_B, SPI2_SS1_B, I2C3_SDA_B, QEC3_Y_B, CDC_D14_A, CAM_D14_B
  P9_7 location=L16 register=P9_7 offset=0x13C muxModes=GPIO9_7, OSPI1_D2_C, UART7_DE_B, SPI2_SS2_B, I2C3_SCL_B, QEC3_Z_B, CDC_D15_A, CAM_D15_B
  P10_0 location=M13 register=P10_0 offset=0x140 muxModes=GPIO10_0, OSPI1_D3_C, UART6_DE_B, SPI2_SS3_B, UT0_T0_C, LPCAM_HSYNC_A, CDC_D16_A, CAM_HSYNC_B
  P10_1 location=M15 register=P10_1 offset=0x144 muxModes=GPIO10_1, OSPI1_D4_C, Reserved, LPI2S_SDI_B, UT0_T1_C, LPCAM_VSYNC_A, CDC_D17_A, CAM_VSYNC_B
  P10_2 location=N18 register=P10_2 offset=0x148 muxModes=GPIO10_2, OSPI1_D5_C, Reserved, LPI2S_SDO_B, UT1_T0_C, LPCAM_PCLK_A, CDC_D18_A, CAM_PCLK_B
  P10_3 location=P15 register=P10_3 offset=0x14C muxModes=GPIO10_3, OSPI1_D6_C, Reserved, LPI2S_SCLK_B, UT1_T1_C, LPCAM_XVCLK_A, CDC_D19_A, CAM_XVCLK_B
  P10_4 location=R16 register=P10_4 offset=0x150 muxModes=GPIO10_4, OSPI1_D7_C, Reserved, LPI2S_WS_B, I2C0_SDA_D, UT2_T0_C, ETH_TXD0_B, CDC_D20_A
  P10_5 location=R14 register=P10_5 offset=0x154 muxModes=GPIO10_5, UART6_RX_A, I2S2_SDI_B, SPI3_MISO_B, I2C0_SCL_D, UT2_T1_C, ETH_TXD1_B, CDC_D21_A
  P10_6 location=T15 register=P10_6 offset=0x158 muxModes=GPIO10_6, UART6_TX_A, I2S2_SDO_B, SPI3_MOSI_B, I2C1_SDA_D, UT3_T0_C, ETH_TXEN_B, CDC_D22_A
  P10_7 location=T17 register=P10_7 offset=0x15C muxModes=GPIO10_7, UART7_RX_A, I2S2_SCLK_B, SPI3_SCLK_B, I2C1_SCL_D, UT3_T1_C, CDC_D23_A, OSPI1_RXDS0_C
  P11_0 location=P13 register=P11_0 offset=0x160 muxModes=GPIO11_0, OSPI1_D0_A, UART7_TX_A, I2S2_WS_B, SPI3_SS0_B, UT4_T0_C, ETH_REFCLK_B, CDC_D0_B
  P11_1 location=U18 register=P11_1 offset=0x164 muxModes=GPIO11_1, OSPI1_D1_A, UART7_DE_A, SPI3_SS1_B, UT4_T1_C, ETH_MDIO_B, CDC_D1_B, LPSPI_SS5_A
  P11_2 location=N12 register=P11_2 offset=0x168 muxModes=GPIO11_2, OSPI1_D2_A, UART6_DE_A, LPPDM_C2_B, SPI3_SS2_B, UT5_T0_C, ETH_MDC_B, CDC_D2_B
  P11_3 location=M11 register=P11_3 offset=0x16C muxModes=GPIO11_3, OSPI1_D3_A, UART5_RX_B, LPPDM_C3_B, SPI3_SS3_B, UT5_T1_C, ETH_RXD0_B, CDC_D3_B
  P11_4 location=Y13 register=P11_4 offset=0x170 muxModes=GPIO11_4, OSPI1_D4_A, UART5_TX_B, PDM_C2_B, LPSPI_MISO_B, UT6_T0_C, ETH_RXD1_B, CDC_D4_B
  P11_5 location=AD17 register=P11_5 offset=0x174 muxModes=GPIO11_5, OSPI1_D5_A, UART6_RX_B, PDM_C3_B, LPSPI_MOSI_B, UT6_T1_C, ETH_CRS_DV_B, CDC_D5_B
  P11_6 location=AA14 register=P11_6 offset=0x178 muxModes=GPIO11_6, OSPI1_D6_A, UART6_TX_B, LPPDM_D2_B, LPSPI_SCLK_B, UT7_T0_C, ETH_RST_B, CDC_D6_B
  P11_7 location=AC16 register=P11_7 offset=0x17C muxModes=GPIO11_7, OSPI1_D7_A, UART5_DE_B, LPPDM_D3_B, LPSPI_SS0_B, UT7_T1_C, ETH_IRQ_B, CDC_D7_B
  P12_0 location=E2 register=P12_0 offset=0x180 muxModes=GPIO12_0, OSPI0_SCLK_C, AUDIO_CLK_C, I2S1_SDI_B, UT8_T0_C, CDC_D8_B, OSPI1_D8_B, LPUT0_T0_B
  P12_1 location=D1 register=P12_1 offset=0x184 muxModes=GPIO12_1, OSPI0_SCLKN_C, UART4_RX_B, I2S1_SDO_B, UT8_T1_C, CDC_D9_B, OSPI1_D9_B, LPUT0_T1_B
  P12_2 location=K5 register=P12_2 offset=0x188 muxModes=GPIO12_2, OSPI0_RXDS0_C, UART4_TX_B, I2S1_SCLK_B, UT9_T0_C, CDC_D10_B, OSPI1_D10_B, LPUT1_T0_B
  P12_3 location=J6 register=P12_3 offset=0x18C muxModes=GPIO12_3, OSPI0_SS0_C, UART4_DE_B, I2S1_WS_B, UT9_T1_C, CDC_D11_B, OSPI1_D11_B, LPUT1_T1_B
  P12_4 location=A10 register=P12_4 offset=0x190 muxModes=GPIO12_4, OSPI0_SS1_C, SPI3_MISO_A, UT10_T0_C, CAN_RXD_C, CDC_D12_B, OSPI1_D12_B, LPUT2_T0_B
  P12_5 location=J10 register=P12_5 offset=0x194 muxModes=GPIO12_5, Reserved, SPI3_MOSI_A, UT10_T1_C, CAN_TXD_C, CDC_D13_B, OSPI1_D13_B, LPUT2_T1_B
  P12_6 location=H11 register=P12_6 offset=0x198 muxModes=GPIO12_6, Reserved, SPI3_SCLK_A, UT11_T0_C, CAN_STBY_C, CDC_D14_B, OSPI1_D14_B
  P12_7 location=F11 register=P12_7 offset=0x19C muxModes=GPIO12_7, OSPI1_RXDS0_B, Reserved, SPI3_SS0_A, UT11_T1_C, CDC_D15_B
  P13_0 location=H3 register=P13_0 offset=0x1A0 muxModes=GPIO13_0, OSPI1_D0_B, Reserved, SPI3_SS1_A, QEC0_X_C, SD_D0_B, CDC_D16_B, OSPI0_D8_A
  P13_1 location=G2 register=P13_1 offset=0x1A4 muxModes=GPIO13_1, OSPI1_D1_B, SPI3_SS2_A, QEC0_Y_C, SD_D1_B, CDC_D17_B, OSPI0_D9_A
  P13_2 location=F1 register=P13_2 offset=0x1A8 muxModes=GPIO13_2, OSPI1_D2_B, SPI3_SS3_A, QEC0_Z_C, SD_D2_B, CDC_D18_B, OSPI0_D10_A
  P13_3 location=J4 register=P13_3 offset=0x1AC muxModes=GPIO13_3, OSPI1_D3_B, SPI2_SS3_A, QEC1_X_C, SD_D3_B, CDC_D19_B, OSPI0_D11_A
  P13_4 location=G4 register=P13_4 offset=0x1B0 muxModes=GPIO13_4, OSPI1_D4_B, LPI2S_SDI_C, QEC1_Y_C, SD_D4_B, CDC_D20_B, OSPI0_D12_A
  P13_5 location=D5 register=P13_5 offset=0x1B4 muxModes=GPIO13_5, OSPI1_D5_B, LPI2S_SDO_C, QEC1_Z_C, SD_D5_B, CDC_D21_B, OSPI0_D13_A
  P13_6 location=E6 register=P13_6 offset=0x1B8 muxModes=GPIO13_6, OSPI1_D6_B, LPI2S_SCLK_C, QEC2_X_C, SD_D6_B, CDC_D22_B, OSPI0_D14_A
  P13_7 location=A4 register=P13_7 offset=0x1BC muxModes=GPIO13_7, OSPI1_D7_B, LPI2S_WS_C, QEC2_Y_C, SD_D7_B, CDC_D23_B, OSPI0_D15_A
  P14_0 location=B11 register=P14_0 offset=0x1C0 muxModes=GPIO14_0, OSPI1_SCLK_B, UART6_RX_C, QEC2_Z_C, SD_CMD_B, LFRC_OUT_B
  P14_1 location=G14 register=P14_1 offset=0x1C4 muxModes=GPIO14_1, OSPI1_SCLKN_B, UART6_TX_C, APLL_OUT_C, QEC3_X_C, SD_CLK_B, LFXO_OUT_B
  P14_2 location=F15 register=P14_2 offset=0x1C8 muxModes=GPIO14_2, OSPI1_SS0_B, UART7_RX_C, LPI3C_SDA_C, QEC3_Y_C, SD_RST_B, LPSPI_SS5_B
  P14_3 location=U12 register=P14_3 offset=0x1CC muxModes=GPIO14_3, OSPI1_SS1_B, UART7_TX_C, LPI3C_SCL_C, QEC3_Z_C
  P14_4 location=W12 register=P14_4 offset=0x1D0 muxModes=GPIO14_4, CMP3_OUT_B, SPI1_MISO_C, FAULT0_C, OSPI1_RXDS1_A, LPSPI_SS1_B
  P14_5 location=V11 register=P14_5 offset=0x1D4 muxModes=GPIO14_5, CMP2_OUT_B, SPI1_MOSI_C, FAULT1_C, OSPI0_RXDS1_B, LPSPI_SS2_B
  P14_6 location=Y11 register=P14_6 offset=0x1D8 muxModes=GPIO14_6, CMP1_OUT_B, SPI1_SCLK_C, FAULT2_C, OSPI1_D15_B, LPSPI_SS3_B
  P14_7 location=AD15 register=P14_7 offset=0x1DC muxModes=GPIO14_7, CMP0_OUT_B, SPI1_SS0_C, FAULT3_C, APLL_OUT_B, LPSPI_SS4_B
  P15_0 location=T13 register=LPGPIO_CTRL_0 offset=0x0 muxModes=GPIOV_0, LPTMR0_CLK_IO
  P15_1 location=R12 register=LPGPIO_CTRL_1 offset=0x4 muxModes=GPIOV_1, LPTMR1_CLK_IO
  P15_2 location=AA18 register=LPGPIO_CTRL_2 offset=0x8 muxModes=GPIOV_2, LPTMR2_CLK_IO
  P15_3 location=P11 register=LPGPIO_CTRL_3 offset=0xC muxModes=GPIOV_3, LPTMR3_CLK_IO
  P15_4 location=T11 register=LPGPIO_CTRL_4 offset=0x10 muxModes=GPIOV_4, LFXO_OUT_C
  P15_5 location=V13 register=LPGPIO_CTRL_5 offset=0x14 muxModes=GPIOV_5, LFRC_OUT_C
  P15_6 location=AC18 register=LPGPIO_CTRL_6 offset=0x18 muxModes=GPIOV_6
  P15_7 location=W14 register=LPGPIO_CTRL_7 offset=0x1C muxModes=GPIOV_7
  P16_0 location=L10 register=P16_0 offset=0x20 muxModes=GPIO16_0, OSPI0_D8_B
  P16_1 location=M9 register=P16_1 offset=0x24 muxModes=GPIO16_1, OSPI0_D9_B
  P16_2 location=P9 register=P16_2 offset=0x28 muxModes=GPIO16_2, OSPI0_D10_B
  P16_3 location=AC6 register=P16_3 offset=0x2C muxModes=GPIO16_3, OSPI0_D11_B
  P16_4 location=AA6 register=P16_4 offset=0x30 muxModes=GPIO16_4, OSPI0_D12_B
  P16_5 location=T9 register=P16_5 offset=0x34 muxModes=GPIO16_5, OSPI0_D13_B
  P16_6 location=R8 register=P16_6 offset=0x38 muxModes=GPIO16_6, OSPI0_D14_B
  P16_7 location=U8 register=P16_7 offset=0x3C muxModes=GPIO16_7, OSPI0_D15_B
  P17_0 location=K15 register=P17_0 offset=0x40 muxModes=GPIO17_0, OSPI1_D8_C
  P17_1 location=L14 register=P17_1 offset=0x44 muxModes=GPIO17_1, OSPI1_D9_C
  P17_2 location=L18 register=P17_2 offset=0x48 muxModes=GPIO17_2, OSPI1_D10_C
  P17_3 location=M17 register=P17_3 offset=0x4C muxModes=GPIO17_3, OSPI1_D11_C
  P17_4 location=N14 register=P17_4 offset=0x50 muxModes=GPIO17_4, OSPI1_D12_C
  P17_5 location=N16 register=P17_5 offset=0x54 muxModes=GPIO17_5, OSPI1_D13_C
  P17_6 location=P17 register=P17_6 offset=0x58 muxModes=GPIO17_6, OSPI1_D14_C
  P17_7 location=R18 register=P17_7 offset=0x5C muxModes=GPIO17_7, OSPI1_D15_C
  VREG_AUX_1_1V8 location=AA4 register=NA offset=NA muxModes=VREG_AUX_1_1V8
  VREG_AUX_2_1V8 location=Y3 register=NA offset=NA muxModes=VREG_AUX_2_1V8
  SEUART_RX location=F5 register=NA offset=NA muxModes=SEUART_RX
  SEUART_TX location=E4 register=NA offset=NA muxModes=SEUART_TX
  VSS location=B1 register=NA offset=NA muxModes=VSS
  N.C. location=XX1 register=NA offset=NA muxModes=N.C.
  N.C. location=XX2 register=NA offset=NA muxModes=N.C.
  N.C. location=E16 register=NA offset=NA muxModes=N.C.
  N.C. location=K9 register=NA offset=NA muxModes=N.C.
  N.C. location=R6 register=NA offset=NA muxModes=N.C.
  NSRST location=H5 register=NA offset=NA muxModes=NSRST
  POR_N location=N8 register=NA offset=NA muxModes=POR_N
  HFXO_P location=D15 register=NA offset=NA muxModes=HFXO_P
  HFXO_N location=C16 register=NA offset=NA muxModes=HFXO_N
  LFXO_P location=U6 register=NA offset=NA muxModes=LFXO_P
  LFXO_N location=Y5 register=NA offset=NA muxModes=LFXO_N
  VREF_P location=V3 register=NA offset=NA muxModes=VREF_P
  VREF_N location=U4 register=NA offset=NA muxModes=VREF_N
  VDD_MAIN location=W2 register=NA offset=NA muxModes=VDD_MAIN
  VDD_BATT location=T7 register=NA offset=NA muxModes=VDD_BATT
  VDD_BUCK location=AB1 register=NA offset=NA muxModes=VDD_BUCK
  VDD_IO_FLEX location=V15 register=NA offset=NA muxModes=VDD_IO_FLEX
  VDD_IO_1V8 location=Y17 register=NA offset=NA muxModes=VDD_IO_1V8
  VDD_IO_1V8 location=A8 register=NA offset=NA muxModes=VDD_IO_1V8
  VDD_IO_1V8 location=W6 register=NA offset=NA muxModes=VDD_IO_1V8
  VDD_IO_1V8 location=J2 register=NA offset=NA muxModes=VDD_IO_1V8
  VDD_CORE_0V8 location=E18 register=NA offset=NA muxModes=VDD_CORE_0V8
  VDD_CORE_0V8 location=AB15 register=NA offset=NA muxModes=VDD_CORE_0V8
  VDD_CORE_0V8 location=D9 register=NA offset=NA muxModes=VDD_CORE_0V8
  VDD_CORE_0V8 location=AB5 register=NA offset=NA muxModes=VDD_CORE_0V8
  VDD_CORE_0V8 location=K3 register=NA offset=NA muxModes=VDD_CORE_0V8
  VREG_MIPI_0V8 location=N10 register=NA offset=NA muxModes=VREG_MIPI_0V8
  VDD_MIPI_1V8 location=R10 register=NA offset=NA muxModes=VDD_MIPI_1V8
  VDD_USB_3V3 location=AC12 register=NA offset=NA muxModes=VDD_USB_3V3
  VDD_SX_0V8 location=B15 register=NA offset=NA muxModes=VDD_SX_0V8
  VDD_PLL_0V8 location=XX3 register=NA offset=NA muxModes=VDD_PLL_0V8
  VSS_RF location=B17 register=NA offset=NA muxModes=VSS_RF
  VDD_ANA_0V8 location=A18 register=NA offset=NA muxModes=VDD_ANA_0V8
  VSS_BUCK location=AD1 register=NA offset=NA muxModes=VSS_BUCK
  VSS_ANA location=Y1 register=NA offset=NA muxModes=VSS_ANA
  VSS location=AB17 register=NA offset=NA muxModes=VSS
  VSS location=F17 register=NA offset=NA muxModes=VSS
  VSS location=W16 register=NA offset=NA muxModes=VSS
  VSS location=A16 register=NA offset=NA muxModes=VSS
  VSS location=AD13 register=NA offset=NA muxModes=VSS
  VSS location=U10 register=NA offset=NA muxModes=VSS
  VSS location=B9 register=NA offset=NA muxModes=VSS
  VSS location=AD5 register=NA offset=NA muxModes=VSS
  VSS location=AC4 register=NA offset=NA muxModes=VSS
  VSS location=H1 register=NA offset=NA muxModes=VSS
  VREG_CORE_0V8 location=V5 register=NA offset=NA muxModes=VREG_CORE_0V8
  VREG_AON location=V7 register=NA offset=NA muxModes=VREG_AON
  VREG_LP_1V8 location=W4 register=NA offset=NA muxModes=VREG_LP_1V8
  VREG_DIG_1V8 location=AD3 register=NA offset=NA muxModes=VREG_DIG_1V8
  VREG_AUX_1V8 location=XX4 register=NA offset=NA muxModes=VREG_AUX_1V8
  VREG_MIPI_1V8 location=V1 register=NA offset=NA muxModes=VREG_MIPI_1V8
  VSW location=AB3 register=NA offset=NA muxModes=VSW
  VSW location=AC2 register=NA offset=NA muxModes=VSW
  USB_REXT location=AD11 register=NA offset=NA muxModes=USB_REXT
  USB_DP location=AC14 register=NA offset=NA muxModes=USB_DP
  USB_DM location=AB13 register=NA offset=NA muxModes=USB_DM
  USB_VBUS location=AB11 register=NA offset=NA muxModes=USB_VBUS
  USB_IO_ID location=AA12 register=NA offset=NA muxModes=USB_IO_ID
  MIPI_REXT location=V9 register=NA offset=NA muxModes=MIPI_REXT
  MIPICSI_0_P location=AC8 register=NA offset=NA muxModes=MIPICSI_0_P
  MIPICSI_0_N location=AA8 register=NA offset=NA muxModes=MIPICSI_0_N
  MIPICSI_1_P location=AD7 register=NA offset=NA muxModes=MIPICSI_1_P
  MIPICSI_1_N location=AB7 register=NA offset=NA muxModes=MIPICSI_1_N
  MIPICSI_C_P location=W8 register=NA offset=NA muxModes=MIPICSI_C_P
  MIPICSI_C_N location=Y7 register=NA offset=NA muxModes=MIPICSI_C_N
  MIPIDSI_0_P location=AB9 register=NA offset=NA muxModes=MIPIDSI_0_P
  MIPIDSI_0_N location=AD9 register=NA offset=NA muxModes=MIPIDSI_0_N
  MIPIDSI_1_P location=AA10 register=NA offset=NA muxModes=MIPIDSI_1_P
  MIPIDSI_1_N location=AC10 register=NA offset=NA muxModes=MIPIDSI_1_N
  MIPIDSI_C_P location=W10 register=NA offset=NA muxModes=MIPIDSI_C_P
  MIPIDSI_C_N location=Y9 register=NA offset=NA muxModes=MIPIDSI_C_N
clocks:
  CRC0
    HCLK clkSource=SYST_HCLK clkDesc=CRC0 AHB slave interface clock
  CRC1
    HCLK clkSource=SYST_HCLK clkDesc=CRC1 AHB slave interface clock
  IRQRTR
    CLKIN clkSource=SYST_REFCLK clkDesc=IRQRTR functional and interface clock
  EVTRTR0
    CLKIN clkSource=SYST_ACLK clkDesc=EVTRTR0 functional and interface clock
  EVTRTR1
    CLKIN clkSource=RTSS_HP_CLK clkDesc=EVTRTR1 functional and interface clock
  EVTRTR2
    CLKIN clkSource=RTSS_HE_CLK clkDesc=EVTRTR2 functional and interface clock
  DMA0_SEC
    ACLK clkSource=SYST_ACLK clkDesc=AXI master interface clock and DMAC functional clock
  DMA0_NS
    ACLK clkSource=SYST_ACLK clkDesc=AXI master interface clock and DMAC functional clock
  DMA1_SEC
    ACLK clkSource=RTSS_HP_CLK clkDesc=AXI master interface clock and DMAC functional clock
  DMA1_NS
    ACLK clkSource=RTSS_HP_CLK clkDesc=AXI master interface clock and DMAC functional clock
  DMA2_SEC
    ACLK clkSource=RTSS_HE_CLK clkDesc=AXI master interface clock and DMAC functional clock
  DMA2_NS
    ACLK clkSource=RTSS_HE_CLK clkDesc=AXI master interface clock and DMAC functional clock
  LPTIMER0
    LPTIMER0_CLK clkSource=S32K_CLK, 128K_CLK, or LPTMR0_CLK_IO pin; Clock selection in the respective TIMER_CLKSEL[SELn] register bit clkDesc=LPTIMER0 timer clock
    PCLK clkSource=RTSS_HE_CLK clkDesc=LPTIMER0 APB bus clock
  LPTIMER1
    LPTIMER1_CLK clkSource=S32K_CLK, 128K_CLK, LPTMR1_CLK_IO pin, or LPTMR0_OUT; Clock selection in the respective TIMER_CLKSEL[SELn] register bit clkDesc=LPTIMER1 timer clock
    PCLK clkSource=RTSS_HE_CLK clkDesc=LPTIMER1 APB bus clock
  LPTIMER2
    LPTIMER2_CLK clkSource=S32K_CLK, 128K_CLK, or LPTMR2_CLK_IO pin; Clock selection in the respective TIMER_CLKSEL[SELn] register bit clkDesc=LPTIMER2 timer clock
    PCLK clkSource=RTSS_HE_CLK clkDesc=LPTIMER2 APB bus clock
  LPTIMER3
    LPTIMER3_CLK clkSource=S32K_CLK, 128K_CLK, LPTMR3_CLK_IO pin, or LPTMR2_OUT; Clock selection in the respective TIMER_CLKSEL[SELn] register bit clkDesc=LPTIMER3 timer clock
    PCLK clkSource=RTSS_HE_CLK clkDesc=LPTIMER3 APB bus clock
  UTIMER{n} (n=0..11)
    ACLK clkSource=SYST_ACLK clkDesc=Functional and AHB interface clock
  QEC0
    ACLK clkSource=SYST_ACLK clkDesc=Functional and AHB interface clock
  QEC1
    ACLK clkSource=SYST_ACLK clkDesc=Functional and AHB interface clock
  QEC2
    ACLK clkSource=SYST_ACLK clkDesc=Functional and AHB interface clock
  QEC3
    ACLK clkSource=SYST_ACLK clkDesc=Functional and AHB interface clock
  WDT_HP
    PCLK clkSource=RTSS_HP_CLK clkDesc=APB interface clock
    WDOGCLK0 clkSource=RTSS_HP_CLK clkDesc=WDT_HP functional clock
  WDT_HE
    PCLK clkSource=RTSS_HE_CLK clkDesc=APB interface clock
    WDOGCLK1 clkSource=RTSS_HE_CLK clkDesc=WDT_HE functional clock
  LPRTC0
    LPRTC0_CLK clkSource=S32K_CLK; Clock source for S32K_CLK (LFRC or LFXO) can be selected by the clock select register bit: MISC_CTRL[SEL_32K] clkDesc=LPRTC0 counter clock
    PCLK clkSource=RTSS_HE_CLK clkDesc=LPRTC0 APB bus clock
  REFCLK_TMR
    CNT_CLK clkSource=SYST_REFCLK clkDesc=Functional clock for the counter and timers
    IF_CLK clkSource=SYST_REFCLK clkDesc=Interface clock for the registers
    SYNC_CLK clkSource=S32K_CLK clkDesc=Synchronization clock. See REFCLK_CNTSCR[ENSYNC].
  S32KCLK_TMR
    CNT_CLK clkSource=S32K_CLK clkDesc=Functional clock for the counter and timers
    IF_CLK clkSource=SYST_REFCLK clkDesc=Interface clock for the registers
  GPIO{n} (n=0..14)
    DBCLK clkSource=RTSS_HE_CLK,SYST_PCLK / DIV clkDesc=GPIO{n} debounce clock
    PCLK clkSource=RTSS_HE_CLK,SYST_PCLK clkDesc=GPIO{n} APB interface clock
    PCLK_INTR clkSource=RTSS_HE_CLK,SYST_PCLK clkDesc=GPIO{n} interrupt clock
  GPIO16
    DBCLK clkSource=RTSS_HE_CLK clkDesc=GPIO16 debounce clock
    PCLK clkSource=RTSS_HE_CLK clkDesc=GPIO16 APB interface clock
    PCLK_INTR clkSource=RTSS_HE_CLK clkDesc=GPIO16 interrupt clock
  GPIO17
    DBCLK clkSource=RTSS_HE_CLK clkDesc=GPIO17 debounce clock
    PCLK clkSource=RTSS_HE_CLK clkDesc=GPIO17 APB interface clock
    PCLK_INTR clkSource=RTSS_HE_CLK clkDesc=GPIO17 interrupt clock
  LPGPIO
    DBCLK clkSource=128K_CLK or 10M_CLK; Clock selection is done via the SEL_FAST_APB_REG[SEL_FAST_APB_REG] register bit clkDesc=LPGPIO debounce clock
    PCLK clkSource=128K_CLK or 10M_CLK; Clock selection is done via the SEL_FAST_APB_REG[SEL_FAST_APB_REG] register bit clkDesc=LPGPIO APB interface clock
    PCLK_INTR clkSource=128K_CLK or 10M_CLK; Clock selection is done via the SEL_FAST_APB_REG[SEL_FAST_APB_REG] register bit clkDesc=LPGPIO interrupt clock
  CANFD0
    CANFD0_CLK clkSource=(HFOSC_CLK or PERIPH_CLK) / DIV (selection in CANFD_CTRL[CLK_SEL] register bit); (divider can be controlled by the CANFD_CTRL[CKDIV] field) clkDesc=CANFD0 functional clock
    CANFD0_HOST_CLK clkSource=SYST_PCLK clkDesc=CANFD0 APB host interface clock
    CANFD0_TIMER_CLK clkSource=SYST_PCLK clkDesc=CANFD0 CAN-CNT counter clock
  ETH
    ACLK clkSource=SYST_HCLK clkDesc=AXI master interface clock. The DMA also uses this clock.
    CLK_CSR clkSource=SYST_HCLK clkDesc=AHB slave interface clock
    CLK_PTP clkSource=100M_CLK clkDesc=Reference clock for the timestamp update logic
    RMII_CLK clkSource=ETH_CLK; Selection in ETH_CTRL0[RMII_CLKSEL] clkDesc=RMII Clock. This is the 50-MHz clock used by the RMII interface.
    RX_CLK clkSource=ETH_CLK/2 or ; ETH_CLK/2/10; Selection in ETH_MAC_CONFIGURATION[FES] clkDesc=Receive clock
    TX_CLK clkSource=ETH_CLK/2 or ; ETH_CLK/2/10; Selection in ETH_MAC_CONFIGURATION[FES] clkDesc=Transmit clock
  I2C0
    IC_CLK clkSource=SYST_PCLK clkDesc=I2C0 peripheral clock
    PCLK clkSource=SYST_PCLK clkDesc=I2C0 APB interface clock
  I2C1
    IC_CLK clkSource=SYST_PCLK clkDesc=I2C1 peripheral clock
    PCLK clkSource=SYST_PCLK clkDesc=I2C1 APB interface clock
  I2C2
    IC_CLK clkSource=SYST_PCLK clkDesc=I2C2 peripheral clock
    PCLK clkSource=SYST_PCLK clkDesc=I2C2 APB interface clock
  I2C3
    IC_CLK clkSource=SYST_PCLK clkDesc=I2C3 peripheral clock
    PCLK clkSource=SYST_PCLK clkDesc=I2C3 APB interface clock
  LPI2C0
    PCLK clkSource=RTSS_HE_CLK clkDesc=LPI2C0 APB interface clock
  LPI2C1
    PCLK clkSource=RTSS_HE_CLK clkDesc=LPI2C1 APB interface clock
  I2S0
    PCLK clkSource=SYST_PCLK clkDesc=APB slave interface clock
    SCLK clkSource=[76M8_CLK or (AUDIO_PLL_CLK or AUDIO_CLK pin)] / DIV; Clock selection between AUDIO_PLL_CLK and AUDIO_CLK pin (MUX1) can be controlled via the SEL_AUDIO_CLK[SEL_AUDIO_CLK] bit. Clock selection between 76M8_CLK and audio clock (MUX2) can be controlled via the I2Sn_CTRL[CLK_SEL] bit. Clock divider can be controlled via the I2Sn_CTRL[CKDIV] field or it can be bypassed via the I2Sn_CTRL[DIV_BYPASS] field clkDesc=Serial interface clock
    SCLK_N clkSource=[76M8_CLK or (AUDIO_PLL_CLK or AUDIO_CLK pin)] / DIV; Clock selection between AUDIO_PLL_CLK and AUDIO_CLK pin (MUX1) can be controlled via the SEL_AUDIO_CLK[SEL_AUDIO_CLK] bit. Clock selection between 76M8_CLK and audio clock (MUX2) can be controlled via the I2Sn_CTRL[CLK_SEL] bit. Clock divider can be controlled via the I2Sn_CTRL[CKDIV] field or it can be bypassed via the I2Sn_CTRL[DIV_BYPASS] field clkDesc=Inverted serial interface clock
  I2S1
    PCLK clkSource=SYST_PCLK clkDesc=APB slave interface clock
    SCLK clkSource=[76M8_CLK or (AUDIO_PLL_CLK or AUDIO_CLK pin)] / DIV; Clock selection between AUDIO_PLL_CLK and AUDIO_CLK pin (MUX1) can be controlled via the SEL_AUDIO_CLK[SEL_AUDIO_CLK] bit. Clock selection between 76M8_CLK and audio clock (MUX2) can be controlled via the I2Sn_CTRL[CLK_SEL] bit. Clock divider can be controlled via the I2Sn_CTRL[CKDIV] field or it can be bypassed via the I2Sn_CTRL[DIV_BYPASS] field clkDesc=Serial interface clock
    SCLK_N clkSource=[76M8_CLK or (AUDIO_PLL_CLK or AUDIO_CLK pin)] / DIV; Clock selection between AUDIO_PLL_CLK and AUDIO_CLK pin (MUX1) can be controlled via the SEL_AUDIO_CLK[SEL_AUDIO_CLK] bit. Clock selection between 76M8_CLK and audio clock (MUX2) can be controlled via the I2Sn_CTRL[CLK_SEL] bit. Clock divider can be controlled via the I2Sn_CTRL[CKDIV] field or it can be bypassed via the I2Sn_CTRL[DIV_BYPASS] field clkDesc=Inverted serial interface clock
  I2S2
    PCLK clkSource=SYST_PCLK clkDesc=APB slave interface clock
    SCLK clkSource=[76M8_CLK or (AUDIO_PLL_CLK or AUDIO_CLK pin)] / DIV; Clock selection between AUDIO_PLL_CLK and AUDIO_CLK pin (MUX1) can be controlled via the SEL_AUDIO_CLK[SEL_AUDIO_CLK] bit. Clock selection between 76M8_CLK and audio clock (MUX2) can be controlled via the I2Sn_CTRL[CLK_SEL] bit. Clock divider can be controlled via the I2Sn_CTRL[CKDIV] field or it can be bypassed via the I2Sn_CTRL[DIV_BYPASS] field clkDesc=Serial interface clock
    SCLK_N clkSource=[76M8_CLK or (AUDIO_PLL_CLK or AUDIO_CLK pin)] / DIV; Clock selection between AUDIO_PLL_CLK and AUDIO_CLK pin (MUX1) can be controlled via the SEL_AUDIO_CLK[SEL_AUDIO_CLK] bit. Clock selection between 76M8_CLK and audio clock (MUX2) can be controlled via the I2Sn_CTRL[CLK_SEL] bit. Clock divider can be controlled via the I2Sn_CTRL[CKDIV] field or it can be bypassed via the I2Sn_CTRL[DIV_BYPASS] field clkDesc=Inverted serial interface clock
  I2S3
    PCLK clkSource=SYST_PCLK clkDesc=APB slave interface clock
    SCLK clkSource=[76M8_CLK or (AUDIO_PLL_CLK or AUDIO_CLK pin)] / DIV; Clock selection between AUDIO_PLL_CLK and AUDIO_CLK pin (MUX1) can be controlled via the SEL_AUDIO_CLK[SEL_AUDIO_CLK] bit. Clock selection between 76M8_CLK and audio clock (MUX2) can be controlled via the I2Sn_CTRL[CLK_SEL] bit. Clock divider can be controlled via the I2Sn_CTRL[CKDIV] field or it can be bypassed via the I2Sn_CTRL[DIV_BYPASS] field clkDesc=Serial interface clock
    SCLK_N clkSource=[76M8_CLK or (AUDIO_PLL_CLK or AUDIO_CLK pin)] / DIV; Clock selection between AUDIO_PLL_CLK and AUDIO_CLK pin (MUX1) can be controlled via the SEL_AUDIO_CLK[SEL_AUDIO_CLK] bit. Clock selection between 76M8_CLK and audio clock (MUX2) can be controlled via the I2Sn_CTRL[CLK_SEL] bit. Clock divider can be controlled via the I2Sn_CTRL[CKDIV] field or it can be bypassed via the I2Sn_CTRL[DIV_BYPASS] field clkDesc=Inverted serial interface clock
  LPI2S
    PCLK clkSource=RTSS_HE_CLK clkDesc=APB slave interface clock
    SCLK clkSource=[76M8_CLK or (AUDIO_PLL_CLK or AUDIO_CLK pin)] / DIV; Clock selection between AUDIO_PLL_CLK and AUDIO_CLK pin (MUX1) can be controlled via the SEL_AUDIO_CLK[SEL_AUDIO_CLK] bit. Clock selection between 76M8_CLK and audio clock (MUX2) can be controlled via the HE_I2S_CTRL[CLK_SEL] bit. Clock divider can be controlled via the HE_I2S_CTRL[CLK_DIVISOR] field or it can be bypassed via the HE_I2S_CTRL[DIV_BYPASS] field clkDesc=Serial interface clock
    SCLK_N clkSource=[76M8_CLK or (AUDIO_PLL_CLK or AUDIO_CLK pin)] / DIV; Clock selection between AUDIO_PLL_CLK and AUDIO_CLK pin (MUX1) can be controlled via the SEL_AUDIO_CLK[SEL_AUDIO_CLK] bit. Clock selection between 76M8_CLK and audio clock (MUX2) can be controlled via the HE_I2S_CTRL[CLK_SEL] bit. Clock divider can be controlled via the HE_I2S_CTRL[CLK_DIVISOR] field or it can be bypassed via the HE_I2S_CTRL[DIV_BYPASS] field clkDesc=Inverted serial interface clock
  I3C
    CORE_CLK clkSource=SYST_ACLK clkDesc=I3C core interface clock
    DMA_CLK clkSource=SYST_ACLK clkDesc=I3C SDMA interface clock
    PCLK clkSource=SYST_ACLK clkDesc=I3C APB interface clock
  LPI3C
    CORE_CLK clkSource=RTSS_HE_CLK clkDesc=LPI3C core interface clock
    DMA_CLK clkSource=RTSS_HE_CLK clkDesc=LPI3C SDMA interface clock
    PCLK clkSource=RTSS_HE_CLK clkDesc=LPI3C APB interface clock
  PDM
    PCLK clkSource=SYST_PCLK clkDesc=PDM APB interface clock
    PDM_CLK clkSource=[76M8_CLK or (AUDIO_PLL_CLK or AUDIO_CLK pin)] / DIV; Clock selection between AUDIO_PLL_CLK and AUDIO_CLK pin (MUX1) can be controlled by the SEL_AUDIO_CLK[SEL_AUDIO_CLK] bit. Clock selection between 76M8_CLK and audio clock (MUX2) can be controlled by the EXPMST0_CTRL[PDM_SEL] bit clkDesc=PDM functional clock
  LPPDM
    LPPDM_CLK clkSource=[76M8_CLK or (AUDIO_PLL_CLK or AUDIO_CLK pin)] / DIV; Clock selection between AUDIO_PLL_CLK and AUDIO_CLK pin (MUX1) can be controlled by the SEL_AUDIO_CLK[SEL_AUDIO_CLK] bit. Clock selection between 76M8_CLK and audio clock (MUX2) can be controlled by the HE_CLK_ENA[PDM_CKSEL] bit clkDesc=LPPDM functional clock
    PCLK clkSource=RTSS_HE_CLK clkDesc=LPPDM APB interface clock
  SPI0
    HCLK clkSource=SYST_HCLK clkDesc=SPI0 AHB interface clock
    SPI_0_CLK clkSource=SYST_HCLK clkDesc=SPI0 core clock is identical to AHB interface clock
  SPI1
    HCLK clkSource=SYST_HCLK clkDesc=SPI1 AHB interface clock
    SPI_1_CLK clkSource=SYST_HCLK clkDesc=SPI1 core clock is identical to AHB interface clock
  SPI2
    HCLK clkSource=SYST_HCLK clkDesc=SPI2 AHB interface clock
    SPI_2_CLK clkSource=SYST_HCLK clkDesc=SPI2 core clock is identical to AHB interface clock
  SPI3
    HCLK clkSource=SYST_HCLK clkDesc=SPI3 AHB interface clock
    SPI_3_CLK clkSource=SYST_HCLK clkDesc=SPI3 core clock is identical to AHB interface clock
  LPSPI0
    LPSPI_0_CLK clkSource=RTSS_HE_CLK clkDesc=LPSPI0 core clock
    PCLK clkSource=RTSS_HE_CLK clkDesc=LPSPI0 APB interface clock
  UART{n} (n=0..7)
    PCLK clkSource=SYST_PCLK clkDesc=UART{n} APB interface clock
    SCLK clkSource=HFOSC_CLK or SYST_PCLK; (selection in UART_CTRL[CLK_SEL] register field) clkDesc=UART{n} serial interface clock
  LPUART
    PCLK clkSource=RTSS_HE_CLK clkDesc=LPUART APB interface clock
  USB
    BUS_CLK clkSource=SYST_HCLK clkDesc=AHB interface clock
    REF_CLK clkSource=10M_CLK clkDesc=REF_CLK generates the ITP counter when the UTMI PHY is in the suspended state (10 MHz)
  USB2PHY
    USB2_REFCLOCK clkSource=USB_CLK clkDesc=PHY PLL reference clock (20 MHz)
  SDMMC
    ACLK clkSource=SYST_HCLK clkDesc=AXI master interface clock
    BCLK clkSource=100M_CLK clkDesc=SDMMC core base clock
    CCLK_RX clkSource=100M_CLK /Div clkDesc=SDMMC card receive clock
    CCLK_TX clkSource=100M_CLK /Div clkDesc=SDMMC card transmit clock
    HCLK clkSource=SYST_HCLK clkDesc=AHB slave interface clock
    TMCLK clkSource=10M_CLK clkDesc=SDMMC timer clock
  CPI
    ACLK clkSource=SYST_ACLK clkDesc=CPI AXI interface clock
    PCLK clkSource=SYST_PCLK clkDesc=CPI APB interface clock
    PIXEL_CLK clkSource=(SYST_ACLK or 400M_CLK)/Div or CAM_PCLK pin or CAM_PCLK inverted pin clkDesc=CPI pixel clock
  LPCPI
    ACLK clkSource=RTSS_HE_CLK clkDesc=LPCPI AXI interface clock
    PCLK clkSource=RTSS_HE_CLK clkDesc=LPCPI APB interface clock
    PIXEL_CLK clkSource=LPCAM_PCLK pin or LPCAM_PCLK inverted pin clkDesc=LPCPI pixel clock
  CSI
    PCLK clkSource=SYST_PCLK clkDesc=CSI APB slave interface clock
    PIXCLK clkSource=(SYST_ACLK or 400M_CLK) / Div ; (source selection and divider value can be configured in the CSI_PIXCLK_CTRL[CLK_SEL][CLK_DIVISOR] register field) clkDesc=CSI IPI interface pixel clock
    RXBYTECLKHS clkSource=D-PHY RX clkDesc=CSI high-speed receive byte clock
  D-PHYRX
    CFG_CLK clkSource=100M_CLK/4 clkDesc=CSI D-PHY RX configuration clock (25 MHz)
  ISP
    ISP_CLK clkSource=SYST_ACLK clkDesc=ISP functional clock
  JPEG
    JPEG_CLK clkSource=SYST_ACLK clkDesc=JPEG functional clock
  CDC
    ACLK clkSource=SYST_HCLK clkDesc=CDC AXI master interface clock
    PCLK clkSource=SYST_PCLK clkDesc=CDC APB slave interface clock
    PIXEL_CLK clkSource=(SYST_ACLK or 400M_CLK) / Div; (source selection and divider value can be configured in the CDC200_PIXCLK_CTRL[CLK_SEL] and [CLK_DIVISOR] register fields) clkDesc=CDC pixel data clock
  DSI
    LANEBYTECLK clkSource=D-PHY TX clkDesc=DSI lane byte clock
    PCLK clkSource=SYST_PCLK clkDesc=DSI APB slave interface clock
    RXCLKESC clkSource=D-PHY TX clkDesc=DSI RX escape clock
  D-PHYTX
    CFG_CLK clkSource=100M_CLK/4 clkDesc=D-PHY TX configuration clock (25 MHz)
    CLKEXT clkSource=PLL_CLK1 clkDesc=D-PHY TX PLL bypass clock (800 MHz)
    CLKIN clkSource=HFOSC_CLK clkDesc=D-PHY TX PLL reference clock (38.4 MHz)
    TXCLKESC clkSource=DSI clkDesc=DSI escape mode transmit clock
  ADC120
    ADC_CLK clkSource=PERIPH_CLK clkDesc=Functional clock
    PCLK clkSource=SYST_PCLK clkDesc=APB interface clock
  ADC121
    ADC_CLK clkSource=PERIPH_CLK clkDesc=Functional clock
    PCLK clkSource=SYST_PCLK clkDesc=APB interface clock
  ADC122
    ADC_CLK clkSource=PERIPH_CLK clkDesc=Functional clock
    PCLK clkSource=SYST_PCLK clkDesc=APB interface clock
  ADC24
    ADC_CLK clkSource=PERIPH_CLK clkDesc=Functional clock
    PCLK clkSource=SYST_PCLK clkDesc=APB interface clock
  DAC120
    PCLK clkSource=SYST_PCLK clkDesc=Functional and interface clock
  DAC121
    PCLK clkSource=SYST_PCLK clkDesc=Functional and interface clock
  CMP0
    PCLK clkSource=SYST_PCLK or SYST_ACLK; Clock selection in the CMP_CTRL[CMPn_CKSEL] register bits clkDesc=Register interface clock
  CMP1
    PCLK clkSource=SYST_PCLK or SYST_ACLK; Clock selection in the CMP_CTRL[CMPn_CKSEL] register bits clkDesc=Register interface clock
  CMP2
    PCLK clkSource=SYST_PCLK or SYST_ACLK; Clock selection in the CMP_CTRL[CMPn_CKSEL] register bits clkDesc=Register interface clock
  CMP3
    PCLK clkSource=SYST_PCLK or SYST_ACLK; Clock selection in the CMP_CTRL[CMPn_CKSEL] register bits clkDesc=Register interface clock
  LPCMP
    CLK32K clkSource=LFRC,LFXO clkDesc=LPCMP 32-kHz functional clock
  M55-HP
    CLKIN clkSource=RTSS_HP_CLK clkDesc=M55-HP functional and interface clock
  M55-HE
    CLKIN clkSource=RTSS_HE_CLK clkDesc=M55-HE functional and interface clock
  NPU-HG
    CLKIN clkSource=SYST_ACLK clkDesc=NPU-HG 400 MHz functional and interface clock
  GPU2D
    CLK clkSource=SYST_ACLK clkDesc=Functional and AXI interface clock
  HWSEM
    PCLK clkSource=SYST_PCLK clkDesc=APB interface clock
  MHU_SECPU_M55HE_0_RX
    CLK clkSource=RTSS_HE_CLK clkDesc=Interface and functional clock
  MHU_M55HE_SECPU_0_TX
    CLK clkSource=RTSS_HE_CLK clkDesc=Interface and functional clock
  MHU_SECPU_M55HE_1_RX
    CLK clkSource=RTSS_HE_CLK clkDesc=Interface and functional clock
  MHU_M55HE_SECPU_1_TX
    CLK clkSource=RTSS_HE_CLK clkDesc=Interface and functional clock
  MHU_M55HP_M55HE_0_RX
    CLK clkSource=RTSS_HE_CLK clkDesc=Interface and functional clock
  MHU_M55HE_M55HP_0_TX
    CLK clkSource=RTSS_HE_CLK clkDesc=Interface and functional clock
  MHU_M55HP_M55HE_1_RX
    CLK clkSource=RTSS_HE_CLK clkDesc=Interface and functional clock
  MHU_M55HE_M55HP_1_TX
    CLK clkSource=RTSS_HE_CLK,RTSS_HE_CLK clkDesc=Interface and functional clock
  MHU_SECPU_M55HP_0_RX
    CLK clkSource=RTSS_HP_CLK clkDesc=Interface and functional clock
  MHU_M55HP_SECPU_0_TX
    CLK clkSource=RTSS_HP_CLK clkDesc=Interface and functional clock
  MHU_SECPU_M55HP_1_RX
    CLK clkSource=RTSS_HP_CLK clkDesc=Interface and functional clock
  MHU_M55HP_SECPU_1_TX
    CLK clkSource=RTSS_HP_CLK clkDesc=Interface and functional clock
  MHU_M55HE_M55HP_0_RX
    CLK clkSource=RTSS_HP_CLK clkDesc=Interface and functional clock
  MHU_M55HP_M55HE_0_TX
    CLK clkSource=RTSS_HP_CLK clkDesc=Interface and functional clock
  MHU_M55HE_M55HP_1_RX
    CLK clkSource=RTSS_HP_CLK clkDesc=Interface and functional clock
  MHU_M55HP_M55HE_1_TX
    CLK clkSource=RTSS_HP_CLK clkDesc=Interface and functional clock
