# AE612FA0E5597BS0_CM55_HE_View register map
Vendor: Alif Semiconductor; Series: E6; File version: 1.0
CPU: CM55 r1p0, selectable endian, MPU, FPU, double-precision FPU, DSP, VTOR, 8 interrupt priority bits, 1 SAU regions

## Further device data (continued)
clocks:
  CRC0
    HCLK clkSource=SYST_HCLK clkDesc=CRC0 AHB slave interface clock
  CRC1
    HCLK clkSource=SYST_HCLK clkDesc=CRC1 AHB slave interface clock
  GIC
    CLKIN clkSource=SYST_REFCLK clkDesc=GIC functional and interface clock
  IRQRTR
    CLKIN clkSource=SYST_REFCLK clkDesc=IRQRTR functional and interface clock
  EVTRTR0
    CLKIN clkSource=SYST_ACLK clkDesc=EVTRTR0 functional and interface clock
  EVTRTR1
    CLKIN clkSource=RTSS_HP_CLK clkDesc=EVTRTR1 functional and interface clock
  EVTRTR2
    CLKIN clkSource=RTSS_HE_CLK clkDesc=EVTRTR2 functional and interface clock
  DMA0_SEC
    ACLK clkSource=SYST_ACLK clkDesc=AXI master interface clock and DMAC functional clock
  DMA0_NS
    ACLK clkSource=SYST_ACLK clkDesc=AXI master interface clock and DMAC functional clock
  DMA1_SEC
    ACLK clkSource=RTSS_HP_CLK clkDesc=AXI master interface clock and DMAC functional clock
  DMA1_NS
    ACLK clkSource=RTSS_HP_CLK clkDesc=AXI master interface clock and DMAC functional clock
  DMA2_SEC
    ACLK clkSource=RTSS_HE_CLK clkDesc=AXI master interface clock and DMAC functional clock
  DMA2_NS
    ACLK clkSource=RTSS_HE_CLK clkDesc=AXI master interface clock and DMAC functional clock
  LPTIMER0
    LPTIMER0_CLK clkSource=S32K_CLK, 128K_CLK, or LPTMR0_CLK_IO pin; Clock selection in the respective TIMER_CLKSEL[SELn] register bit clkDesc=LPTIMER0 timer clock
    PCLK clkSource=RTSS_HE_CLK clkDesc=LPTIMER0 APB bus clock
  LPTIMER1
    LPTIMER1_CLK clkSource=S32K_CLK, 128K_CLK, LPTMR1_CLK_IO pin, or LPTMR0_OUT; Clock selection in the respective TIMER_CLKSEL[SELn] register bit clkDesc=LPTIMER1 timer clock
    PCLK clkSource=RTSS_HE_CLK clkDesc=LPTIMER1 APB bus clock
  LPTIMER2
    LPTIMER2_CLK clkSource=S32K_CLK, 128K_CLK, or LPTMR2_CLK_IO pin; Clock selection in the respective TIMER_CLKSEL[SELn] register bit clkDesc=LPTIMER2 timer clock
    PCLK clkSource=RTSS_HE_CLK clkDesc=LPTIMER2 APB bus clock
  LPTIMER3
    LPTIMER3_CLK clkSource=S32K_CLK, 128K_CLK, LPTMR3_CLK_IO pin, or LPTMR2_OUT; Clock selection in the respective TIMER_CLKSEL[SELn] register bit clkDesc=LPTIMER3 timer clock
    PCLK clkSource=RTSS_HE_CLK clkDesc=LPTIMER3 APB bus clock
  UTIMER{n} (n=0..11)
    ACLK clkSource=SYST_ACLK clkDesc=Functional and AHB interface clock
  QEC0
    ACLK clkSource=SYST_ACLK clkDesc=Functional and AHB interface clock
  QEC1
    ACLK clkSource=SYST_ACLK clkDesc=Functional and AHB interface clock
  QEC2
    ACLK clkSource=SYST_ACLK clkDesc=Functional and AHB interface clock
  QEC3
    ACLK clkSource=SYST_ACLK clkDesc=Functional and AHB interface clock
  WDT_AP
    WDOGCLK2 clkSource=SYST_REFCLK clkDesc=Input clock to WDT_AP
  WDT_AP_S
    WDOGCLK3 clkSource=SYST_REFCLK clkDesc=Input clock to WDT_AP_S
  WDT_HP
    PCLK clkSource=RTSS_HP_CLK clkDesc=APB interface clock
    WDOGCLK0 clkSource=RTSS_HP_CLK clkDesc=WDT_HP functional clock
  WDT_HE
    PCLK clkSource=RTSS_HE_CLK clkDesc=APB interface clock
    WDOGCLK1 clkSource=RTSS_HE_CLK clkDesc=WDT_HE functional clock
  LPRTC0
    LPRTC0_CLK clkSource=S32K_CLK; Clock source for S32K_CLK (LFRC or LFXO) can be selected by the clock select register bit: MISC_CTRL[SEL_32K] clkDesc=LPRTC0 counter clock
    PCLK clkSource=RTSS_HE_CLK clkDesc=LPRTC0 APB bus clock
  REFCLK_TMR
    CNT_CLK clkSource=SYST_REFCLK clkDesc=Functional clock for the counter and timers
    IF_CLK clkSource=SYST_REFCLK clkDesc=Interface clock for the registers
    SYNC_CLK clkSource=S32K_CLK clkDesc=Synchronization clock. See REFCLK_CNTSCR[ENSYNC].
  S32KCLK_TMR
    CNT_CLK clkSource=S32K_CLK clkDesc=Functional clock for the counter and timers
    IF_CLK clkSource=SYST_REFCLK clkDesc=Interface clock for the registers
  GPIO{n} (n=0..14)
    DBCLK clkSource=RTSS_HE_CLK,SYST_PCLK / DIV clkDesc=GPIO{n} debounce clock
    PCLK clkSource=RTSS_HE_CLK,SYST_PCLK clkDesc=GPIO{n} APB interface clock
    PCLK_INTR clkSource=RTSS_HE_CLK,SYST_PCLK clkDesc=GPIO{n} interrupt clock
  GPIO16
    DBCLK clkSource=RTSS_HE_CLK clkDesc=GPIO16 debounce clock
    PCLK clkSource=RTSS_HE_CLK clkDesc=GPIO16 APB interface clock
    PCLK_INTR clkSource=RTSS_HE_CLK clkDesc=GPIO16 interrupt clock
  GPIO17
    DBCLK clkSource=RTSS_HE_CLK clkDesc=GPIO17 debounce clock
    PCLK clkSource=RTSS_HE_CLK clkDesc=GPIO17 APB interface clock
    PCLK_INTR clkSource=RTSS_HE_CLK clkDesc=GPIO17 interrupt clock
  LPGPIO
    DBCLK clkSource=128K_CLK or 10M_CLK; Clock selection is done via the SEL_FAST_APB_REG[SEL_FAST_APB_REG] register bit clkDesc=LPGPIO debounce clock
    PCLK clkSource=128K_CLK or 10M_CLK; Clock selection is done via the SEL_FAST_APB_REG[SEL_FAST_APB_REG] register bit clkDesc=LPGPIO APB interface clock
    PCLK_INTR clkSource=128K_CLK or 10M_CLK; Clock selection is done via the SEL_FAST_APB_REG[SEL_FAST_APB_REG] register bit clkDesc=LPGPIO interrupt clock
  CANFD0
    CANFD0_CLK clkSource=(HFOSC_CLK or PERIPH_CLK) / DIV (selection in CANFD_CTRL[CLK_SEL] register bit); (divider can be controlled by the CANFD_CTRL[CKDIV] field) clkDesc=CANFD0 functional clock
    CANFD0_HOST_CLK clkSource=SYST_PCLK clkDesc=CANFD0 APB host interface clock
    CANFD0_TIMER_CLK clkSource=SYST_PCLK clkDesc=CANFD0 CAN-CNT counter clock
  ETH
    ACLK clkSource=SYST_HCLK clkDesc=AXI master interface clock. The DMA also uses this clock.
    CLK_CSR clkSource=SYST_HCLK clkDesc=AHB slave interface clock
    CLK_PTP clkSource=100M_CLK clkDesc=Reference clock for the timestamp update logic
    RMII_CLK clkSource=ETH_CLK; Selection in ETH_CTRL0[RMII_CLKSEL] clkDesc=RMII Clock. This is the 50-MHz clock used by the RMII interface.
    RX_CLK clkSource=ETH_CLK/2 or ; ETH_CLK/2/10; Selection in ETH_MAC_CONFIGURATION[FES] clkDesc=Receive clock
    TX_CLK clkSource=ETH_CLK/2 or ; ETH_CLK/2/10; Selection in ETH_MAC_CONFIGURATION[FES] clkDesc=Transmit clock
  I2C0
    IC_CLK clkSource=SYST_PCLK clkDesc=I2C0 peripheral clock
    PCLK clkSource=SYST_PCLK clkDesc=I2C0 APB interface clock
  I2C1
    IC_CLK clkSource=SYST_PCLK clkDesc=I2C1 peripheral clock
    PCLK clkSource=SYST_PCLK clkDesc=I2C1 APB interface clock
  I2C2
    IC_CLK clkSource=SYST_PCLK clkDesc=I2C2 peripheral clock
    PCLK clkSource=SYST_PCLK clkDesc=I2C2 APB interface clock
  I2C3
    IC_CLK clkSource=SYST_PCLK clkDesc=I2C3 peripheral clock
    PCLK clkSource=SYST_PCLK clkDesc=I2C3 APB interface clock
  LPI2C0
    PCLK clkSource=RTSS_HE_CLK clkDesc=LPI2C0 APB interface clock
  LPI2C1
    PCLK clkSource=RTSS_HE_CLK clkDesc=LPI2C1 APB interface clock
  I2S0
    PCLK clkSource=SYST_PCLK clkDesc=APB slave interface clock
    SCLK clkSource=[76M8_CLK or (AUDIO_PLL_CLK or AUDIO_CLK pin)] / DIV; Clock selection between AUDIO_PLL_CLK and AUDIO_CLK pin (MUX1) can be controlled via the SEL_AUDIO_CLK[SEL_AUDIO_CLK] bit. Clock selection between 76M8_CLK and audio clock (MUX2) can be controlled via the I2Sn_CTRL[CLK_SEL] bit. Clock divider can be controlled via the I2Sn_CTRL[CKDIV] field or it can be bypassed via the I2Sn_CTRL[DIV_BYPASS] field clkDesc=Serial interface clock
    SCLK_N clkSource=[76M8_CLK or (AUDIO_PLL_CLK or AUDIO_CLK pin)] / DIV; Clock selection between AUDIO_PLL_CLK and AUDIO_CLK pin (MUX1) can be controlled via the SEL_AUDIO_CLK[SEL_AUDIO_CLK] bit. Clock selection between 76M8_CLK and audio clock (MUX2) can be controlled via the I2Sn_CTRL[CLK_SEL] bit. Clock divider can be controlled via the I2Sn_CTRL[CKDIV] field or it can be bypassed via the I2Sn_CTRL[DIV_BYPASS] field clkDesc=Inverted serial interface clock
  I2S1
    PCLK clkSource=SYST_PCLK clkDesc=APB slave interface clock
    SCLK clkSource=[76M8_CLK or (AUDIO_PLL_CLK or AUDIO_CLK pin)] / DIV; Clock selection between AUDIO_PLL_CLK and AUDIO_CLK pin (MUX1) can be controlled via the SEL_AUDIO_CLK[SEL_AUDIO_CLK] bit. Clock selection between 76M8_CLK and audio clock (MUX2) can be controlled via the I2Sn_CTRL[CLK_SEL] bit. Clock divider can be controlled via the I2Sn_CTRL[CKDIV] field or it can be bypassed via the I2Sn_CTRL[DIV_BYPASS] field clkDesc=Serial interface clock
    SCLK_N clkSource=[76M8_CLK or (AUDIO_PLL_CLK or AUDIO_CLK pin)] / DIV; Clock selection between AUDIO_PLL_CLK and AUDIO_CLK pin (MUX1) can be controlled via the SEL_AUDIO_CLK[SEL_AUDIO_CLK] bit. Clock selection between 76M8_CLK and audio clock (MUX2) can be controlled via the I2Sn_CTRL[CLK_SEL] bit. Clock divider can be controlled via the I2Sn_CTRL[CKDIV] field or it can be bypassed via the I2Sn_CTRL[DIV_BYPASS] field clkDesc=Inverted serial interface clock
  I2S2
    PCLK clkSource=SYST_PCLK clkDesc=APB slave interface clock
    SCLK clkSource=[76M8_CLK or (AUDIO_PLL_CLK or AUDIO_CLK pin)] / DIV; Clock selection between AUDIO_PLL_CLK and AUDIO_CLK pin (MUX1) can be controlled via the SEL_AUDIO_CLK[SEL_AUDIO_CLK] bit. Clock selection between 76M8_CLK and audio clock (MUX2) can be controlled via the I2Sn_CTRL[CLK_SEL] bit. Clock divider can be controlled via the I2Sn_CTRL[CKDIV] field or it can be bypassed via the I2Sn_CTRL[DIV_BYPASS] field clkDesc=Serial interface clock
    SCLK_N clkSource=[76M8_CLK or (AUDIO_PLL_CLK or AUDIO_CLK pin)] / DIV; Clock selection between AUDIO_PLL_CLK and AUDIO_CLK pin (MUX1) can be controlled via the SEL_AUDIO_CLK[SEL_AUDIO_CLK] bit. Clock selection between 76M8_CLK and audio clock (MUX2) can be controlled via the I2Sn_CTRL[CLK_SEL] bit. Clock divider can be controlled via the I2Sn_CTRL[CKDIV] field or it can be bypassed via the I2Sn_CTRL[DIV_BYPASS] field clkDesc=Inverted serial interface clock
  I2S3
    PCLK clkSource=SYST_PCLK clkDesc=APB slave interface clock
    SCLK clkSource=[76M8_CLK or (AUDIO_PLL_CLK or AUDIO_CLK pin)] / DIV; Clock selection between AUDIO_PLL_CLK and AUDIO_CLK pin (MUX1) can be controlled via the SEL_AUDIO_CLK[SEL_AUDIO_CLK] bit. Clock selection between 76M8_CLK and audio clock (MUX2) can be controlled via the I2Sn_CTRL[CLK_SEL] bit. Clock divider can be controlled via the I2Sn_CTRL[CKDIV] field or it can be bypassed via the I2Sn_CTRL[DIV_BYPASS] field clkDesc=Serial interface clock
    SCLK_N clkSource=[76M8_CLK or (AUDIO_PLL_CLK or AUDIO_CLK pin)] / DIV; Clock selection between AUDIO_PLL_CLK and AUDIO_CLK pin (MUX1) can be controlled via the SEL_AUDIO_CLK[SEL_AUDIO_CLK] bit. Clock selection between 76M8_CLK and audio clock (MUX2) can be controlled via the I2Sn_CTRL[CLK_SEL] bit. Clock divider can be controlled via the I2Sn_CTRL[CKDIV] field or it can be bypassed via the I2Sn_CTRL[DIV_BYPASS] field clkDesc=Inverted serial interface clock
  LPI2S
    PCLK clkSource=RTSS_HE_CLK clkDesc=APB slave interface clock
    SCLK clkSource=[76M8_CLK or (AUDIO_PLL_CLK or AUDIO_CLK pin)] / DIV; Clock selection between AUDIO_PLL_CLK and AUDIO_CLK pin (MUX1) can be controlled via the SEL_AUDIO_CLK[SEL_AUDIO_CLK] bit. Clock selection between 76M8_CLK and audio clock (MUX2) can be controlled via the HE_I2S_CTRL[CLK_SEL] bit. Clock divider can be controlled via the HE_I2S_CTRL[CLK_DIVISOR] field or it can be bypassed via the HE_I2S_CTRL[DIV_BYPASS] field clkDesc=Serial interface clock
    SCLK_N clkSource=[76M8_CLK or (AUDIO_PLL_CLK or AUDIO_CLK pin)] / DIV; Clock selection between AUDIO_PLL_CLK and AUDIO_CLK pin (MUX1) can be controlled via the SEL_AUDIO_CLK[SEL_AUDIO_CLK] bit. Clock selection between 76M8_CLK and audio clock (MUX2) can be controlled via the HE_I2S_CTRL[CLK_SEL] bit. Clock divider can be controlled via the HE_I2S_CTRL[CLK_DIVISOR] field or it can be bypassed via the HE_I2S_CTRL[DIV_BYPASS] field clkDesc=Inverted serial interface clock
  I3C
    CORE_CLK clkSource=SYST_ACLK clkDesc=I3C core interface clock
    DMA_CLK clkSource=SYST_ACLK clkDesc=I3C SDMA interface clock
    PCLK clkSource=SYST_ACLK clkDesc=I3C APB interface clock
  LPI3C
    CORE_CLK clkSource=RTSS_HE_CLK clkDesc=LPI3C core interface clock
    DMA_CLK clkSource=RTSS_HE_CLK clkDesc=LPI3C SDMA interface clock
    PCLK clkSource=RTSS_HE_CLK clkDesc=LPI3C APB interface clock
  PDM
    PCLK clkSource=SYST_PCLK clkDesc=PDM APB interface clock
    PDM_CLK clkSource=[76M8_CLK or (AUDIO_PLL_CLK or AUDIO_CLK pin)] / DIV; Clock selection between AUDIO_PLL_CLK and AUDIO_CLK pin (MUX1) can be controlled by the SEL_AUDIO_CLK[SEL_AUDIO_CLK] bit. Clock selection between 76M8_CLK and audio clock (MUX2) can be controlled by the EXPMST0_CTRL[PDM_SEL] bit clkDesc=PDM functional clock
  LPPDM
    LPPDM_CLK clkSource=[76M8_CLK or (AUDIO_PLL_CLK or AUDIO_CLK pin)] / DIV; Clock selection between AUDIO_PLL_CLK and AUDIO_CLK pin (MUX1) can be controlled by the SEL_AUDIO_CLK[SEL_AUDIO_CLK] bit. Clock selection between 76M8_CLK and audio clock (MUX2) can be controlled by the HE_CLK_ENA[PDM_CKSEL] bit clkDesc=LPPDM functional clock
    PCLK clkSource=RTSS_HE_CLK clkDesc=LPPDM APB interface clock
  SPI0
    HCLK clkSource=SYST_HCLK clkDesc=SPI0 AHB interface clock
    SPI_0_CLK clkSource=SYST_HCLK clkDesc=SPI0 core clock is identical to AHB interface clock
  SPI1
    HCLK clkSource=SYST_HCLK clkDesc=SPI1 AHB interface clock
    SPI_1_CLK clkSource=SYST_HCLK clkDesc=SPI1 core clock is identical to AHB interface clock
  SPI2
    HCLK clkSource=SYST_HCLK clkDesc=SPI2 AHB interface clock
    SPI_2_CLK clkSource=SYST_HCLK clkDesc=SPI2 core clock is identical to AHB interface clock
  SPI3
    HCLK clkSource=SYST_HCLK clkDesc=SPI3 AHB interface clock
    SPI_3_CLK clkSource=SYST_HCLK clkDesc=SPI3 core clock is identical to AHB interface clock
  LPSPI0
    LPSPI_0_CLK clkSource=RTSS_HE_CLK clkDesc=LPSPI0 core clock
    PCLK clkSource=RTSS_HE_CLK clkDesc=LPSPI0 APB interface clock
  UART{n} (n=0..7)
    PCLK clkSource=SYST_PCLK clkDesc=UART{n} APB interface clock
    SCLK clkSource=HFOSC_CLK or SYST_PCLK; (selection in UART_CTRL[CLK_SEL] register field) clkDesc=UART{n} serial interface clock
  LPUART
    PCLK clkSource=RTSS_HE_CLK clkDesc=LPUART APB interface clock
  USB
    BUS_CLK clkSource=SYST_HCLK clkDesc=AHB interface clock
    REF_CLK clkSource=10M_CLK clkDesc=REF_CLK generates the ITP counter when the UTMI PHY is in the suspended state (10 MHz)
  USB2PHY
    USB2_REFCLOCK clkSource=USB_CLK clkDesc=PHY PLL reference clock (20 MHz)
  SDMMC
    ACLK clkSource=SYST_HCLK clkDesc=AXI master interface clock
    BCLK clkSource=100M_CLK clkDesc=SDMMC core base clock
    CCLK_RX clkSource=100M_CLK /Div clkDesc=SDMMC card receive clock
    CCLK_TX clkSource=100M_CLK /Div clkDesc=SDMMC card transmit clock
    HCLK clkSource=SYST_HCLK clkDesc=AHB slave interface clock
    TMCLK clkSource=10M_CLK clkDesc=SDMMC timer clock
  CPI
    ACLK clkSource=SYST_ACLK clkDesc=CPI AXI interface clock
    PCLK clkSource=SYST_PCLK clkDesc=CPI APB interface clock
    PIXEL_CLK clkSource=(SYST_ACLK or 400M_CLK)/Div or CAM_PCLK pin or CAM_PCLK inverted pin clkDesc=CPI pixel clock
  LPCPI
    ACLK clkSource=RTSS_HE_CLK clkDesc=LPCPI AXI interface clock
    PCLK clkSource=RTSS_HE_CLK clkDesc=LPCPI APB interface clock
    PIXEL_CLK clkSource=LPCAM_PCLK pin or LPCAM_PCLK inverted pin clkDesc=LPCPI pixel clock
  CSI
    PCLK clkSource=SYST_PCLK clkDesc=CSI APB slave interface clock
    PIXCLK clkSource=(SYST_ACLK or 400M_CLK) / Div ; (source selection and divider value can be configured in the CSI_PIXCLK_CTRL[CLK_SEL][CLK_DIVISOR] register field) clkDesc=CSI IPI interface pixel clock
    RXBYTECLKHS clkSource=D-PHY RX clkDesc=CSI high-speed receive byte clock
  D-PHYRX
    CFG_CLK clkSource=100M_CLK/4 clkDesc=CSI D-PHY RX configuration clock (25 MHz)
  ISP
    ISP_CLK clkSource=SYST_ACLK clkDesc=ISP functional clock
  JPEG
    JPEG_CLK clkSource=SYST_ACLK clkDesc=JPEG functional clock
  A32Cluster
    CLKIN clkSource=APSS_CLK clkDesc=A32 functional and interface clock
  CDC
    ACLK clkSource=SYST_HCLK clkDesc=CDC AXI master interface clock
    PCLK clkSource=SYST_PCLK clkDesc=CDC APB slave interface clock
    PIXEL_CLK clkSource=(SYST_ACLK or 400M_CLK) / Div; (source selection and divider value can be configured in the CDC200_PIXCLK_CTRL[CLK_SEL] and [CLK_DIVISOR] register fields) clkDesc=CDC pixel data clock
  DSI
    LANEBYTECLK clkSource=D-PHY TX clkDesc=DSI lane byte clock
    PCLK clkSource=SYST_PCLK clkDesc=DSI APB slave interface clock
    RXCLKESC clkSource=D-PHY TX clkDesc=DSI RX escape clock
  D-PHYTX
    CFG_CLK clkSource=100M_CLK/4 clkDesc=D-PHY TX configuration clock (25 MHz)
    CLKEXT clkSource=PLL_CLK1 clkDesc=D-PHY TX PLL bypass clock (800 MHz)
    CLKIN clkSource=HFOSC_CLK clkDesc=D-PHY TX PLL reference clock (38.4 MHz)
    TXCLKESC clkSource=DSI clkDesc=DSI escape mode transmit clock
  ADC120
    ADC_CLK clkSource=PERIPH_CLK clkDesc=Functional clock
    PCLK clkSource=SYST_PCLK clkDesc=APB interface clock
  ADC121
    ADC_CLK clkSource=PERIPH_CLK clkDesc=Functional clock
    PCLK clkSource=SYST_PCLK clkDesc=APB interface clock
  ADC122
    ADC_CLK clkSource=PERIPH_CLK clkDesc=Functional clock
    PCLK clkSource=SYST_PCLK clkDesc=APB interface clock
  ADC24
    ADC_CLK clkSource=PERIPH_CLK clkDesc=Functional clock
    PCLK clkSource=SYST_PCLK clkDesc=APB interface clock
  DAC120
    PCLK clkSource=SYST_PCLK clkDesc=Functional and interface clock
  DAC121
    PCLK clkSource=SYST_PCLK clkDesc=Functional and interface clock
  CMP0
    PCLK clkSource=SYST_PCLK or SYST_ACLK; Clock selection in the CMP_CTRL[CMPn_CKSEL] register bits clkDesc=Register interface clock
  CMP1
    PCLK clkSource=SYST_PCLK or SYST_ACLK; Clock selection in the CMP_CTRL[CMPn_CKSEL] register bits clkDesc=Register interface clock
  CMP2
    PCLK clkSource=SYST_PCLK or SYST_ACLK; Clock selection in the CMP_CTRL[CMPn_CKSEL] register bits clkDesc=Register interface clock
  CMP3
    PCLK clkSource=SYST_PCLK or SYST_ACLK; Clock selection in the CMP_CTRL[CMPn_CKSEL] register bits clkDesc=Register interface clock
  LPCMP
    CLK32K clkSource=LFRC,LFXO clkDesc=LPCMP 32-kHz functional clock
  M55-HP
    CLKIN clkSource=RTSS_HP_CLK clkDesc=M55-HP functional and interface clock
  M55-HE
    CLKIN clkSource=RTSS_HE_CLK clkDesc=M55-HE functional and interface clock
  NPU-HG
    CLKIN clkSource=SYST_ACLK clkDesc=NPU-HG 400 MHz functional and interface clock
  GPU2D
    CLK clkSource=SYST_ACLK clkDesc=Functional and AXI interface clock
  HWSEM
    PCLK clkSource=SYST_PCLK clkDesc=APB interface clock
  MHU_M55HE_A32_0_RX
    CLK clkSource=APSS_CLK clkDesc=Interface and functional clock
  MHU_A32_M55HE_0_TX
    CLK clkSource=APSS_CLK clkDesc=Interface and functional clock
  MHU_M55HE_A32_1_RX
    CLK clkSource=APSS_CLK clkDesc=Interface and functional clock
  MHU_A32_M55HE_1_TX
    CLK clkSource=APSS_CLK clkDesc=Interface and functional clock
  MHU_M55HP_A32_0_RX
    CLK clkSource=APSS_CLK clkDesc=Interface and functional clock
  MHU_A32_M55HP_0_TX
    CLK clkSource=APSS_CLK clkDesc=Interface and functional clock
  MHU_M55HP_A32_1_RX
    CLK clkSource=APSS_CLK clkDesc=Interface and functional clock
  MHU_A32_M55HP_1_TX
    CLK clkSource=APSS_CLK clkDesc=Interface and functional clock
  MHU_SECPU_A32_0_RX
    CLK clkSource=APSS_CLK clkDesc=Interface and functional clock
  MHU_A32_SECPU_0_TX
    CLK clkSource=APSS_CLK clkDesc=Interface and functional clock
  MHU_SECPU_A32_1_RX
    CLK clkSource=APSS_CLK clkDesc=Interface and functional clock
  MHU_A32_SECPU_1_TX
    CLK clkSource=APSS_CLK,APSS_CLK clkDesc=Interface and functional clock
  MHU_A32_M55HE_0_RX
    CLK clkSource=RTSS_HE_CLK clkDesc=Interface and functional clock
  MHU_M55HE_A32_0_TX
    CLK clkSource=RTSS_HE_CLK clkDesc=Interface and functional clock
  MHU_A32_M55HE_1_RX
    CLK clkSource=RTSS_HE_CLK clkDesc=Interface and functional clock
  MHU_M55HE_A32_1_TX
    CLK clkSource=RTSS_HE_CLK clkDesc=Interface and functional clock
  MHU_SECPU_M55HE_0_RX
    CLK clkSource=RTSS_HE_CLK clkDesc=Interface and functional clock
  MHU_M55HE_SECPU_0_TX
    CLK clkSource=RTSS_HE_CLK clkDesc=Interface and functional clock
  MHU_SECPU_M55HE_1_RX
    CLK clkSource=RTSS_HE_CLK clkDesc=Interface and functional clock
  MHU_M55HE_SECPU_1_TX
    CLK clkSource=RTSS_HE_CLK clkDesc=Interface and functional clock
  MHU_M55HP_M55HE_0_RX
    CLK clkSource=RTSS_HE_CLK clkDesc=Interface and functional clock
  MHU_M55HE_M55HP_0_TX
    CLK clkSource=RTSS_HE_CLK clkDesc=Interface and functional clock
  MHU_M55HP_M55HE_1_RX
    CLK clkSource=RTSS_HE_CLK clkDesc=Interface and functional clock
  MHU_M55HE_M55HP_1_TX
    CLK clkSource=RTSS_HE_CLK,RTSS_HE_CLK clkDesc=Interface and functional clock
  MHU_A32_M55HP_0_RX
    CLK clkSource=RTSS_HP_CLK clkDesc=Interface and functional clock
  MHU_M55HP_A32_0_TX
    CLK clkSource=RTSS_HP_CLK clkDesc=Interface and functional clock
  MHU_A32_M55HP_1_RX
    CLK clkSource=RTSS_HP_CLK clkDesc=Interface and functional clock
  MHU_M55HP_A32_1_TX
    CLK clkSource=RTSS_HP_CLK clkDesc=Interface and functional clock
  MHU_SECPU_M55HP_0_RX
    CLK clkSource=RTSS_HP_CLK clkDesc=Interface and functional clock
  MHU_M55HP_SECPU_0_TX
    CLK clkSource=RTSS_HP_CLK clkDesc=Interface and functional clock
  MHU_SECPU_M55HP_1_RX
    CLK clkSource=RTSS_HP_CLK clkDesc=Interface and functional clock
  MHU_M55HP_SECPU_1_TX
    CLK clkSource=RTSS_HP_CLK clkDesc=Interface and functional clock
  MHU_M55HE_M55HP_0_RX
    CLK clkSource=RTSS_HP_CLK clkDesc=Interface and functional clock
  MHU_M55HP_M55HE_0_TX
    CLK clkSource=RTSS_HP_CLK clkDesc=Interface and functional clock
  MHU_M55HE_M55HP_1_RX
    CLK clkSource=RTSS_HP_CLK clkDesc=Interface and functional clock
  MHU_M55HP_M55HE_1_TX
    CLK clkSource=RTSS_HP_CLK clkDesc=Interface and functional clock
