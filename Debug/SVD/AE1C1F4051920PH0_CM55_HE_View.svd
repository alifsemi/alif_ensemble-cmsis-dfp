# AE1C1F4051920PH0_CM55_HE_View register map
Vendor: Alif Semiconductor; Series: E1; File version: 1.0
The families of fusion processors and microcontrollers (MCUs) from Alif Semiconductor create a scalable and compatible continuum of highly integrated embedded processor devices for use in low-end to high-end intelligent IoT end-point applications. Architected for power efficiency and long battery life, these devices deliver high computation and ML/AI capability, multi-layered security, computer vision, and highly interactive human-machine interface.
CPU: CM55 r1p0, selectable endian, MPU, FPU, double-precision FPU, DSP, VTOR, 8 interrupt priority bits, 1 SAU regions
Registers are 32-bit, read-write, reset 0x0 unless marked. A register's access mark holds for its fields unless they carry their own. Offsets are from the block's base; lines under a group give offsets from that group; [hi:lo] are bit positions; {n}, {i} and the like mark numbered series; 'fields as' and 'values as' point back to an identical list; <NAME> marks a mode.

## Memory map
0x1A010000 CLKCTL_SYS blocks up to offset 0xA0C
0x1A200000 REFCLK_CNTControl size 0x10
0x1A210000 REFCLK_CNTRead size 0x8
0x1A220000 REFCLK_CNTCtl size 0xA0
0x1A230000 REFCLK_CNTBase0 size 0x40
0x1A240000 REFCLK_CNTBase1 size 0x40
0x1A250000 REFCLK_CNTBase2 size 0x40
0x1A260000 REFCLK_CNTBase3 size 0x40
0x1A400000 S32K_CNTControl size 0x10
0x1A410000 S32K_CNTRead size 0x8
0x1A420000 S32K_CNTCtl size 0xA0
0x1A430000 S32K_CNTBase0 size 0x40
0x1A440000 S32K_CNTBase1 size 0x40
0x1A500000 IRQRTR size 0xFB4
0x1A602000 CGU size 0x24
0x1A603000 PINMUX size 0x120
0x1A604000 AON blocks up to offset 0x44
0x1A609000 VBAT size 0x14
0x1A60A000 ANA size 0x44
0x1A60F000 STOP_MODE size 0x4
0x40040000 MHU_SECPU_M55HE_0_RX size 0x1000
0x40050000 MHU_M55HE_SECPU_0_TX size 0x1000
0x40060000 MHU_SECPU_M55HE_1_RX size 0x1000
0x40070000 MHU_M55HE_SECPU_1_TX size 0x1000
0x400C0000 DMA2_SEC size 0x1000
0x400E0000 DMA2_NS size 0x1000
0x400E1000 NPU_HE size 0x1000
0x400E2000 EVTRTR2 size 0xA0
0x40100000 WDT_HE_CTRL size 0x1000
0x40101000 WDT_HE_REFRESH size 0x1000
0x42000000 LPRTC0 size 0x28
0x42001000 LPTIMER size 0xB8
0x42002000 LPGPIO size 0x110
0x42007000 LPGPIO_CTRL size 0x8
0x43000000 LPSPI0 size 0xF0
0x43001000 LPI2S size 0x204
0x43002000 LPPDM size 0x7D8
0x43003000 LPCPI size 0x34
0x43004000 LPSPI1 size 0xF0
0x43007000 M55HE_CFG size 0x2C
0x43008000 LPUART size 0x100
0x43009000 LPI2C size 0x24
0x4300A000 HCI_UART size 0x100
0x4300B000 AHI_UART size 0x100
0x48000000 UTIMER size 0x4138
0x48102000 SDMMC size 0xF70
0x48103000 SPI0 size 0xF4
0x48104000 SPI1 size 0xF4
0x48105000 SPI2 size 0xF4
0x48107000 CRC size 0x100
0x48200000 USB size 0xCA04
{0x49000000+0x1000*n} GPIO{n} size 0x110 (n=0..8)
0x49010000 I2C0 size 0x100
0x49011000 I2C1 size 0x100
0x49014000 I2S0 size 0x204
0x49015000 I2S1 size 0x204
0x49018000 UART0 size 0x100
0x49019000 UART1 size 0x100
0x4901A000 UART2 size 0x100
0x4901B000 UART3 size 0x100
0x4901C000 UART4 size 0x100
0x4901D000 UART5 size 0x100
0x49020000 ADC120 size 0x74
0x49021000 ADC121 size 0x74
0x49023000 CMP0 size 0x28
0x49024000 CMP1 size 0x28
0x49027000 ADC24 size 0x74
0x49028000 DAC12 size 0x8
0x4902F000 CLKCTL_PER_SLV size 0xA4
0x49031000 CDC size 0x254
0x49032000 DSI size 0x194
0x49034000 I3C size 0x284
0x49036000 CANFD0 size 0xD1
0x49037000 CANFD0_CNT size 0xC
0x49038000 CANFD1 size 0xD1
0x49039000 CANFD1_CNT size 0xC
0x4903F000 CLKCTL_PER_MST blocks up to offset 0xB0
0x49040000 GPU2D size 0xEC
0x83000000 OSPI size 0x14C
0x83001000 AES size 0x24
0xE000E100 M55HE_NVIC_S size 0x4E0
0xE002E100 M55HE_NVIC_NS size 0x4E0

## Interrupts
{n} DMA2_IRQ{n} (DMA2_SEC, DMA2_NS) (n=0..31) — Interrupt request {n}. One per DMA request interface (32 in total).
32 DMA2_IRQ_ABORT (DMA2_SEC, DMA2_NS) — DMAC aborted execution of a program thread.
37 MHU_SECPU_M55HE_0_RX_IRQ (MHU_SECPU_M55HE_0_RX) — Interrupt
38 MHU_M55HE_SECPU_0_TX_IRQ (MHU_M55HE_SECPU_0_TX) — Interrupt
39 MHU_SECPU_M55HE_1_RX_IRQ (MHU_SECPU_M55HE_1_RX) — Interrupt
40 MHU_M55HE_SECPU_1_TX_IRQ (MHU_M55HE_SECPU_1_TX) — Interrupt
45 LPUART_IRQ (LPUART) — LPUART interrupt request
47 LPI2C_IRQ (LPI2C) — LPI2C interrupt request
48 LPI2S_IRQ (LPI2S) — LPI2S interrupt request
49 LPPDM_IRQ (LPPDM) — LPPDM combined (OR-ed) interrupt of following requests : Warning interrupt request (WARN_IRQ) Error interrupt request (ERROR_IRQ) Audio peak detection interrupt request (AUDIO_DET_IRQ) Upon interrupt assertion, the LPPDM interrupt status registers should be read to identify the source of the interrupt.
50 HCI_UART_IRQ (HCI_UART) — HCI_UART interrupt request
51 AHI_UART_IRQ (AHI_UART) — AHI_UART interrupt request
54 LPCAM_IRQ (LPCPI) — LPCPI interrupt
57 LPGPIO_COMB_IRQ (LPGPIO) — LPGPIO combined interrupt request
58 LPRTC0_IRQ (LPRTC0) — LPRTC0 interrupt request
60 LPTIMER0_IRQ (LPTIMER) — LPTIMER0 interrupt request
61 LPTIMER1_IRQ (LPTIMER) — LPTIMER1 interrupt request
67 REFCLK_CNTBASE0_IRQ (REFCLK_CNTBase0) — Interrupt generated when the timer condition is met. See registers CNTP_TVAL and CNTP_CTL for the timer condition definition.
68 REFCLK_CNTBASE1_IRQ (REFCLK_CNTBase1) — Interrupt generated when the timer condition is met. See registers CNTP_TVAL and CNTP_CTL for the timer condition definition.
69 REFCLK_CNTBASE2_IRQ (REFCLK_CNTBase2) — Interrupt generated when the timer condition is met. See registers CNTP_TVAL and CNTP_CTL for the timer condition definition.
70 REFCLK_CNTBASE3_IRQ (REFCLK_CNTBase3) — Interrupt generated when the timer condition is met. See registers CNTP_TVAL and CNTP_CTL for the timer condition definition.
71 S32K_CNTBASE0_IRQ (S32K_CNTBase0) — Interrupt generated when the timer condition is met. See registers CNTP_TVAL and CNTP_CTL for the timer condition definition.
72 S32K_CNTBASE1_IRQ (S32K_CNTBase1) — Interrupt generated when the timer condition is met. See registers CNTP_TVAL and CNTP_CTL for the timer condition definition.
101 USB_IRQ (USB) — USB interrupt
102 SDMMC_IRQ (SDMMC) — SDMMC Interrupt request
103 SDMMC_WAKEUP_IRQ (SDMMC) — SDMMC Wakeup event interrupt request
104 CANFD0_IRQ (CANFD0) — CANFD0 Interrupt request
105 CANFD1_IRQ (CANFD1) — CANFD1 Interrupt request
124 UART0_IRQ (UART0) — UART0 interrupt request
125 UART1_IRQ (UART1) — UART1 interrupt request
126 UART2_IRQ (UART2) — UART2 interrupt request
127 UART3_IRQ (UART3) — UART3 interrupt request
128 UART4_IRQ (UART4) — UART4 interrupt request
129 UART5_IRQ (UART5) — UART5 interrupt request
132 I2C0_IRQ (I2C0) — I2C0 interrupt request
133 I2C1_IRQ (I2C1) — I2C1 interrupt request
136 I3C_IRQ (I3C) — I3C interrupt request
137 SPI0_IRQ (SPI0) — SPI0 interrupt request
138 SPI1_IRQ (SPI1) — SPI1 interrupt request
139 SPI2_IRQ (SPI2) — SPI2 interrupt request
141 I2S0_IRQ (I2S0) — I2S0 interrupt request
142 I2S1_IRQ (I2S1) — I2S1 interrupt request
151 ADC120_DONE0_IRQ (ADC120) — Averaged sample ready
152 ADC121_DONE0_IRQ (ADC121) — Averaged sample ready
154 ADC120_DONE1_IRQ (ADC120) — All samples taken
155 ADC121_DONE1_IRQ (ADC121) — All samples taken
157 ADC120_CMPA_IRQ (ADC120) — Comparator A interrupt
158 ADC121_CMPA_IRQ (ADC121) — Comparator A interrupt
160 ADC120_CMPB_IRQ (ADC120) — Comparator B interrupt
161 ADC121_CMPB_IRQ (ADC121) — Comparator B interrupt
163 ADC24_DONE0_IRQ (ADC24) — Averaged sample ready
164 ADC24_DONE1_IRQ (ADC24) — All samples taken
165 ADC24_CMPA_IRQ (ADC24) — Comparator A interrupt
166 ADC24_CMPB_IRQ (ADC24) — Comparator B interrupt
167 CMP0_IRQ (CMP0) — Comparator result changed
168 CMP1_IRQ (CMP1) — Comparator result changed
171 LPGPIO_IRQ0 (LPGPIO) — LPGPIO interrupt request 0
172 LPGPIO_IRQ1 (LPGPIO) — LPGPIO interrupt request 1
{8n+179} GPIO{n}_IRQ0 (GPIO{n}) (n=0..8) — GPIO{n} interrupt request 0
{8n+180} GPIO{n}_IRQ1 (GPIO{n}) (n=0..8) — GPIO{n} interrupt request 1
{8n+181} GPIO{n}_IRQ2 (GPIO{n}) (n=0..8) — GPIO{n} interrupt request 2
{8n+182} GPIO{n}_IRQ3 (GPIO{n}) (n=0..8) — GPIO{n} interrupt request 3
{8n+183} GPIO{n}_IRQ4 (GPIO{n}) (n=0..8) — GPIO{n} interrupt request 4
{8n+184} GPIO{n}_IRQ5 (GPIO{n}) (n=0..8) — GPIO{n} interrupt request 5
{8n+185} GPIO{n}_IRQ6 (GPIO{n}) (n=0..8) — GPIO{n} interrupt request 6
{8n+186} GPIO{n}_IRQ7 (GPIO{n}) (n=0..8) — GPIO{n} interrupt request 7
332 GPU2D_IRQ (GPU2D) — GPU2D aggregated interrupt request
333 CDC_SCANLINE0_IRQ (CDC) — CDC line interrupt
335 CDC_FIFO_WARNING0_IRQ (CDC) — CDC FIFO underrun warning interrupt
337 CDC_FIFO_UNDERRUN0_IRQ (CDC) — CDC layer FIFO underrun interrupt
339 CDC_BUS_ERROR0_IRQ (CDC) — CDC bus error interrupt
341 CDC_REG_RELOAD0_IRQ (CDC) — CDC register reload interrupt
343 DSI_IRQ (DSI) — DSI error interrupt
{n+377} UTIMER_IRQ{n} (UTIMER) (n=0..7) — Channel 0, interrupt request {n}
{n+377} UTIMER_IRQ{n} (UTIMER) (n=8..15) — Channel 1, interrupt request {n}
{n+377} UTIMER_IRQ{n} (UTIMER) (n=16..23) — Channel 2, interrupt request {n}
{n+377} UTIMER_IRQ{n} (UTIMER) (n=24..31) — Channel 3, interrupt request {n}
