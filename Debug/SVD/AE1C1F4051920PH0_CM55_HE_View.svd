# AE1C1F4051920PH0_CM55_HE_View register map
Vendor: Alif Semiconductor; Series: E1; File version: 1.0
CPU: CM55 r1p0, selectable endian, MPU, FPU, double-precision FPU, DSP, VTOR, 8 interrupt priority bits, 1 SAU regions

## Further device data
features: package=FBGA120 ioPins=71 sramSize=2 mramSize=1.9 ospiSize=512 securityType=Enclave gpuType=2D GPU displayType=24b Parallel, MIPI DSI cameraType=8b Parallel temp=-40105 adc12=2,12 adc24=1,24 dac=1,12 cmp=2 timer=4,32 qec=4,32 i2c=2 i2s=2 can=2 ospi=1 sdio=1,8 spi=3,50000000 uart=6,2500000 usbotg=1
books:
  https://alifsemi.com/contact-us/ type=Datasheet title=Datasheet - Contact Alif representative
  https://alifsemi.com/contact-us/ type=Hardware Reference Manual title=HWRM - Contact Alif representative
  https://swrm.alifsemi.com type=SWRM title=Software Reference Manual
cpus:
  M55-HE core=Cortex-M55 revision=r1p0 endian=Configurable mpuPresent=true fpuPresent=true fpuDP=true dspPresent=true vtorPresent=true nvicPrioBits=8 vendorSystickConfig=false sauNumRegions=1 pmuPresent=true pmuNumEventCnt=8 mvePresent=true mveFP=true tzPresent=true cpuClock=160000000
memories:
  Utility_SRAM start=0x4902C000 size=0x00001000 access=rw default=1
  SRAM0 start=0x58000000 size=0x00080000 access=rw default=1
  SRAM1 start=0x58800000 size=0x00180000 access=rw default=1
  MRAM start=0x80000000 size=0x001df000 access=rx default=1
  OSPI0 start=0xA0000000 size=0x20000000 access=rwx default=1
firewalls:
  FCTLR ProtectionExtension=PE.1 MonitorExtension=ME.0 TranslationExtension=TE.0 RegionSizeExtension=RSE.1 num_rgn=3 mnrs=4KB mxrs=2MB num_mpe=1 single_mst=0 location=Slave side protectedRegion=0x1A80_0000 - 0x1A8E_FFFF
  FC1 ProtectionExtension=PE.1 MonitorExtension=ME.0 TranslationExtension=TE.0 RegionSizeExtension=RSE.0 num_rgn=22 mnrs=4KB mxrs=512MB num_mpe=1 single_mst=0 location=Slave side protectedRegion=0x1000_0000 - 0x17FF_FFFF, 0x1B00_0000 - 0x1E0F_FFFF
  FC2 ProtectionExtension=PE.1 MonitorExtension=ME.0 TranslationExtension=TE.0 RegionSizeExtension=RSE.0 num_rgn=1 mnrs=4KB mxrs=512MB num_mpe=1 single_mst=0 location=Slave side protectedRegion=0x1800_0000 - 0x19FF_FFFF
  FC3 ProtectionExtension=PE.1 MonitorExtension=ME.0 TranslationExtension=TE.0 RegionSizeExtension=RSE.0 num_rgn=40 mnrs=4KB mxrs=8MB num_mpe=1 single_mst=0 location=Slave side protectedRegion=0x1A00_0000 - 0x1A60_FFFF
  FC8 ProtectionExtension=PE.2 MonitorExtension=ME.2 TranslationExtension=TE.2 RegionSizeExtension=RSE.1 num_rgn=8 mnrs=4KB mxrs=4GB num_mpe=1 single_mst=1 location=Master side protectedRegion=M55-HE address map (0x0000_0000 - 0xFFFF_FFFF)
  FC9 ProtectionExtension=PE.2 MonitorExtension=ME.2 TranslationExtension=TE.2 RegionSizeExtension=RSE.1 num_rgn=8 mnrs=4KB mxrs=4GB num_mpe=4 single_mst=0 location=Master side protectedRegion=Reserved
  FC11 ProtectionExtension=PE.2 MonitorExtension=ME.0 TranslationExtension=TE.0 RegionSizeExtension=RSE.0 num_rgn=8 mnrs=256B mxrs=512MB num_mpe=4 single_mst=0 location=Slave side protectedRegion=0x4000_0000 - 0x5FFF_FFFF
  FC13 ProtectionExtension=PE.2 MonitorExtension=ME.0 TranslationExtension=TE.0 RegionSizeExtension=RSE.1 num_rgn=16 mnrs=4KB mxrs=2GB num_mpe=4 single_mst=0 location=Slave side protectedRegion=0x8000_0000 - 0xDFFF_FFFF
  FC14 ProtectionExtension=PE.2 MonitorExtension=ME.2 TranslationExtension=TE.2 RegionSizeExtension=RSE.1 num_rgn=4 mnrs=4KB mxrs=4GB num_mpe=2 single_mst=0 location=Master side protectedRegion=Reserved
pins:
  P0_0 location=H13 register=P0_0 offset=0x0 muxModes=GPIO0_0, SEUART_RX_A, UART0_RX_A, LPI2S_SDI_A, SPI0_SS0_A, LPI2C_SCL_A, ANA_S0
  P0_1 location=J13 register=P0_1 offset=0x4 muxModes=GPIO0_1, SEUART_TX_A, UART0_TX_A, LPI2S_SDO_A, SPI0_SS1_A, LPI2C_SDA_A, ANA_S1
  P0_2 location=J12 register=P0_2 offset=0x8 muxModes=GPIO0_2, Reserved, OSPI0_SS0_A, UART0_CTS_A, LPI2S_SCLK_A, SPI0_SS2_A, ANA_S2
  P0_3 location=K8 register=P0_3 offset=0xC muxModes=GPIO0_3, Reserved, OSPI0_SS1_A, UART0_RTS_A, LPI2S_WS_A, SPI1_SS0_A, ANA_S3
  P0_4 location=H6 register=P0_4 offset=0x10 muxModes=GPIO0_4, Reserved, UART1_RX_A, SPI1_SS1_A, FAULT0_A, CAN0_STBY_A, ANA_S4
  P0_5 location=H10 register=P0_5 offset=0x14 muxModes=GPIO0_5, Reserved, UART1_TX_A, SPI1_SS2_A, FAULT1_A, I3C_SCL_A, ANA_S5
  P0_6 location=H8 register=P0_6 offset=0x18 muxModes=GPIO0_6, Reserved, UART1_CTS_A, FAULT2_A, LPCAM_VSYNC_B, I3C_SDA_A, ANA_S6
  P0_7 location=J4 register=P0_7 offset=0x1C muxModes=GPIO0_7, JTAG_TCK, UART1_RTS_A, FAULT3_A, ANA_S7
  P1_0 location=D8 register=P1_0 offset=0x20 muxModes=GPIO1_0, JTAG_TMS, LPPDM_D0_A, SPI0_MISO_A
  P1_1 location=D7 register=P1_1 offset=0x24 muxModes=GPIO1_1, JTAG_TDI, LPPDM_C0_A, SPI0_MOSI_A
  P1_2 location=D5 register=P1_2 offset=0x28 muxModes=GPIO1_2, JTAG_TDO, LPPDM_D1_A, SPI0_SCLK_A
  P1_3 location=N2 register=P1_3 offset=0x2C muxModes=GPIO1_3, LPUART_RTS_A, LPPDM_C1_A, I2S1_SCLK_SLV_A, LPSPI_MISO_A, CAN1_RXD_A, Reserved
  P1_4 location=K4 register=P1_4 offset=0x30 muxModes=GPIO1_4, LPPDM_C2_A, I2S0_SDI_A, LPSPI_MOSI_A, I2C1_SDA_A, CDC_PCLK_A, CAN1_TXD_A, Reserved
  P1_5 location=M4 register=P1_5 offset=0x34 muxModes=GPIO1_5, LPPDM_D2_A, I2S0_SDO_A, LPSPI_SCLK_A, I2C1_SCL_A, SD_RST_A, CDC_DE_A, CAN1_STBY_A
  P1_6 location=N4 register=P1_6 offset=0x38 muxModes=GPIO1_6, UART2_RX_A, LPPDM_C3_A, I2S0_SCLK_A, I2C0_SDA_A, CDC_HSYNC_A, I3C_SDA_B, Reserved
  P1_7 location=M5 register=P1_7 offset=0x3C muxModes=GPIO1_7, UART2_TX_A, LPPDM_D3_A, I2S0_WS_A, I2C0_SCL_A, CDC_VSYNC_A, I3C_SCL_B, Reserved
  P2_0 location=K9 register=P2_0 offset=0x40 muxModes=GPIO2_0, OSPI0_SS0_B, LPUART_RX_A, I2S1_SDI_A, LPSPI_SS_A, LPCAM_HSYNC_B, ANA_S8, Reserved
  P2_1 location=K7 register=P2_1 offset=0x44 muxModes=GPIO2_1, OSPI0_SS1_B, LPUART_TX_A, I2S1_SDO_A, LPI2C_SCL_B, LPCAM_PCLK_B, ANA_S9, Reserved
  P2_2 location=M8 register=P2_2 offset=0x48 muxModes=GPIO2_2, NSRST, ANA_S10, Reserved
  P2_3 location=N8 register=P2_3 offset=0x4C muxModes=GPIO2_3, OSPI0_RXDS_C, LPUART_CTS_A, I2S1_WS_SLV_A, LPI2C_SDA_B, LPCAM_XVCLK_B, ANA_S11, Reserved
  P2_4 location=N7 register=P2_4 offset=0x50 muxModes=GPIO2_4, UART3_RX_A, I2S0_SDI_B, I2C0_SCL_B, FAULT0_B, CAN0_TXD_A, ANA_S12, Reserved
  P2_5 location=M7 register=P2_5 offset=0x54 muxModes=GPIO2_5, UART3_TX_A, I2S0_SDO_B, I2C0_SDA_B, FAULT1_B, CAN0_RXD_A, ANA_S13, Reserved
  P2_6 location=N6 register=P2_6 offset=0x58 muxModes=GPIO2_6, UART4_RX_A, I2S0_SCLK_B, I2C1_SDA_B, FAULT2_B, SD_CMD_B, ANA_S14, Reserved
  P2_7 location=M6 register=P2_7 offset=0x5C muxModes=GPIO2_7, UART4_TX_A, I2S0_WS_B, I2C1_SCL_B, FAULT3_B, SD_CLK_B, ANA_S15, Reserved
  P3_0 location=E2 register=P3_0 offset=0x60 muxModes=GPIO3_0, OSPI0_D0_A, UART5_RX_A, LPPDM_C0_B, I2S1_SDI_B, SPI2_MISO_A, CDC_HSYNC_B, Reserved
  P3_1 location=E4 register=P3_1 offset=0x64 muxModes=GPIO3_1, OSPI0_D1_A, UART5_TX_A, LPPDM_D0_B, I2S1_SDO_B, SPI2_MOSI_A, CDC_VSYNC_B, Reserved
  P3_2 location=F2 register=P3_2 offset=0x68 muxModes=GPIO3_2, OSPI0_D2_A, UART3_RX_B, LPPDM_C1_B, I2S1_SCLK_SLV_B, SPI2_SCLK_A, CDC_PCLK_B, Reserved
  P3_3 location=G2 register=P3_3 offset=0x6C muxModes=GPIO3_3, OSPI0_D3_A, UART3_TX_B, LPPDM_D1_B, I2S1_WS_SLV_B, SPI2_SS0_A, CDC_DE_B, Reserved
  P3_4 location=H2 register=P3_4 offset=0x70 muxModes=GPIO3_4, OSPI0_D4_A, LPPDM_C2_B, SPI1_MISO_A, LPCAM_VSYNC_A, SD_CMD_A, CMP0_OUT_A, Reserved
  P3_5 location=D4 register=P3_5 offset=0x74 muxModes=GPIO3_5, OSPI0_D5_A, LPPDM_D2_B, SPI1_MOSI_A, LPCAM_HSYNC_A, SD_CLK_A, CMP1_OUT_A, Reserved
  P3_6 location=J2 register=P3_6 offset=0x78 muxModes=GPIO3_6, OSPI0_D6_A, UART4_RX_B, LPPDM_C3_B, SPI1_SCLK_A, LPCAM_PCLK_A, Reserved, Reserved
  P3_7 location=H1 register=P3_7 offset=0x7C muxModes=GPIO3_7, OSPI0_D7_A, UART4_TX_B, LPPDM_D3_B, LPCAM_XVCLK_A, SD_RST_B, Reserved, Reserved
  P4_0 location=K2 register=P4_0 offset=0x80 muxModes=GPIO4_0, OSPI0_SCLKN_A, UART0_RX_B, SPI2_SS1_A, UT0_T0_A, LPCAM_D0_A, SD_D0_A
  P4_1 location=J1 register=P4_1 offset=0x84 muxModes=GPIO4_1, OSPI0_RXDS_A, UART0_TX_B, SPI2_SS2_A, UT0_T1_A, LPCAM_D1_A, SD_D1_A
  P4_2 location=F4 register=P4_2 offset=0x88 muxModes=GPIO4_2, HFXO_OUT_A, OSPI0_SCLK_A, UART4_DE_A, UT1_T0_A, LPCAM_D2_A, SD_D2_A
  P4_3 location=F6 register=P4_3 offset=0x8C muxModes=GPIO4_3, JTAG_TRACECLK, LPI2S_SDI_B, UT1_T1_A, LPCAM_D3_A, SD_D3_A, CMP0_OUT_B, Reserved
  P4_4 location=A6 register=P4_4 offset=0x90 muxModes=GPIO4_4, JTAG_TDATA0, LPI2S_SDO_B, LPSPI_SCLK_B, UT2_T0_A, LPCAM_D4_A, SD_D4_A, Reserved
  P4_5 location=B6 register=P4_5 offset=0x94 muxModes=GPIO4_5, JTAG_TDATA1, OSPI0_RXDS_B, LPI2S_SCLK_B, UT2_T1_A, LPCAM_D5_A, SD_D5_A, Reserved
  P4_6 location=B5 register=P4_6 offset=0x98 muxModes=GPIO4_6, JTAG_TDATA2, OSPI0_SCLKN_B, LPI2S_WS_B, UT3_T0_A, LPCAM_D6_A, SD_D6_A, Reserved
  P4_7 location=D6 register=P4_7 offset=0x9C muxModes=GPIO4_7, JTAG_TDATA3, OSPI0_SCLK_B, UT3_T1_A, LPCAM_D7_A, SD_D7_A, CMP1_OUT_B, Reserved
  P5_0 location=H12 register=P5_0 offset=0xA0 muxModes=GPIO5_0, OSPI0_D0_B, UART1_RX_B, SPI0_MISO_B, CDC_D0_A, CAN0_RXD_B
  P5_1 location=G13 register=P5_1 offset=0xA4 muxModes=GPIO5_1, OSPI0_D1_B, UART1_TX_B, SPI0_MOSI_B, CDC_D1_A, CAN0_TXD_B
  P5_2 location=F13 register=P5_2 offset=0xA8 muxModes=GPIO5_2, HFXO_OUT_B, OSPI0_D2_B, UART2_RX_B, SPI0_SCLK_B, CDC_D2_A
  P5_3 location=G12 register=P5_3 offset=0xAC muxModes=GPIO5_3, OSPI0_D3_B, UART2_TX_B, SPI0_SS0_B, CDC_D3_A, CAN0_STBY_B
  P5_4 location=G10 register=P5_4 offset=0xB0 muxModes=GPIO5_4, OSPI0_D4_B, UART3_CTS_A, LPPDM_C0_C, SPI0_SS1_B, CDC_D4_A
  P5_5 location=E13 register=P5_5 offset=0xB4 muxModes=GPIO5_5, OSPI0_D5_B, UART3_RTS_A, LPPDM_C1_C, SPI0_SS2_B, CDC_D5_A
  P5_6 location=F12 register=P5_6 offset=0xB8 muxModes=GPIO5_6, OSPI0_D6_B, UART1_CTS_B, LPPDM_D0_C, LPSPI_MISO_B, CDC_D6_A
  P5_7 location=D13 register=P5_7 offset=0xBC muxModes=GPIO5_7, OSPI0_D7_B, UART1_RTS_B, LPPDM_D1_C, LPSPI_MOSI_B, CDC_D7_A
  P6_0 location=E12 register=P6_0 offset=0xC0 muxModes=GPIO6_0, OSPI0_D0_C, UART4_DE_B, LPSPI_SS_B, UT0_T0_B, SD_D0_B, CDC_D8_A
  P6_1 location=B11 register=P6_1 offset=0xC4 muxModes=GPIO6_1, OSPI0_D1_C, UART5_DE_A, SPI1_MISO_B, UT0_T1_B, SD_D1_B, CDC_D9_A
  P6_2 location=A11 register=P6_2 offset=0xC8 muxModes=GPIO6_2, OSPI0_D2_C, UART2_CTS_A, SPI1_MOSI_B, UT1_T0_B, SD_D2_B, CDC_D10_A
  P6_3 location=A10 register=P6_3 offset=0xCC muxModes=GPIO6_3, OSPI0_D3_C, UART2_RTS_A, SPI1_SCLK_B, UT1_T1_B, SD_D3_B, CDC_D11_A
  P6_4 location=B10 register=P6_4 offset=0xD0 muxModes=GPIO6_4, OSPI0_D4_C, UART2_CTS_B, SPI1_SS0_B, UT2_T0_B, SD_D4_B, CDC_D12_A
  P6_5 location=F10 register=P6_5 offset=0xD4 muxModes=GPIO6_5, OSPI0_D5_C, UART2_RTS_B, SPI1_SS1_B, UT2_T1_B, SD_D5_B, CDC_D13_A
  P6_6 location=E10 register=P6_6 offset=0xD8 muxModes=GPIO6_6, OSPI0_D6_C, UART0_CTS_B, SPI1_SS2_B, UT3_T0_B, SD_D6_B, CDC_D14_A
  P6_7 location=D10 register=P6_7 offset=0xDC muxModes=GPIO6_7, OSPI0_D7_C, UART0_RTS_B, SPI2_SS2_C, UT3_T1_B, SD_D7_B, CDC_D15_A
  P7_0 location=D9 register=P7_0 offset=0xE0 muxModes=GPIO7_0, OSPI0_SCLK_C, LPUART_RX_B, SPI2_MISO_B, I2C0_SDA_C, LPCAM_D0_B, CDC_D16_A
  P7_1 location=A5 register=P7_1 offset=0xE4 muxModes=GPIO7_1, OSPI0_SCLKN_C, LPUART_TX_B, SPI2_MOSI_B, I2C0_SCL_C, LPCAM_D1_B, CDC_D17_A
  P7_2 location=A4 register=P7_2 offset=0xE8 muxModes=GPIO7_2, OSPI0_SS0_C, LPUART_CTS_B, SPI2_SCLK_B, I2C1_SDA_C, LPCAM_D2_B, CDC_D18_A
  P7_3 location=B4 register=P7_3 offset=0xEC muxModes=GPIO7_3, OSPI0_SS1_C, LPUART_RTS_B, SPI2_SS0_B, I2C1_SCL_C, LPCAM_D3_B, CDC_D19_A
  P7_4 location=B3 register=P7_4 offset=0xF0 muxModes=GPIO7_4, UART3_CTS_B, LPPDM_C2_C, SPI2_SS1_B, LPI2C_SCL_C, LPCAM_D4_B, CDC_D20_A
  P7_5 location=B7 register=P7_5 offset=0xF4 muxModes=GPIO7_5, UART3_RTS_B, LPPDM_D2_C, SPI2_SS2_B, LPI2C_SDA_C, LPCAM_D5_B, CDC_D21_A
  P7_6 location=G4 register=P7_6 offset=0xF8 muxModes=GPIO7_6, SEUART_RX_C, UART5_RX_B, LPPDM_C3_C, SPI0_MISO_C, LPCAM_D6_B, CDC_D22_A
  P7_7 location=L2 register=P7_7 offset=0xFC muxModes=GPIO7_7, SEUART_TX_C, UART5_TX_B, LPPDM_D3_C, SPI0_MOSI_C, LPCAM_D7_B, CDC_D23_A
  P8_0 location=K1 register=P8_0 offset=0x100 muxModes=GPIO8_0, UART0_RX_C, I2S0_SDI_C, SPI0_SCLK_C, UT0_T0_C, SD_CMD_C, I3C_SCL_C, CMP0_OUT_C
  P8_1 location=H4 register=P8_1 offset=0x104 muxModes=GPIO8_1, UART0_TX_C, I2S0_SDO_C, SPI0_SS0_C, UT0_T1_C, SD_CLK_C, I3C_SDA_C, CMP1_OUT_C
  P8_2 location=L1 register=P8_2 offset=0x108 muxModes=GPIO8_2, SEUART_RX_B, UART1_RX_C, I2S0_SCLK_C, SPI0_SS1_C, UT1_T0_C, SD_RST_C, CAN0_RXD_C
  P8_3 location=M3 register=P8_3 offset=0x10C muxModes=GPIO8_3, SEUART_TX_B, UART1_TX_C, I2S0_WS_C, SPI0_SS2_C, UT1_T1_C, CAN0_TXD_C
  P8_4 location=G6 register=P8_4 offset=0x110 muxModes=GPIO8_4, UART2_RX_C, I2S1_SDI_C, SPI1_MISO_C, UT2_T0_C, LPCAM_VSYNC_C, CAN0_STBY_C
  P8_5 location=M1 register=P8_5 offset=0x114 muxModes=GPIO8_5, UART2_TX_C, I2S1_SDO_C, SPI1_MOSI_C, UT2_T1_C, LPCAM_HSYNC_C, CAN1_RXD_B
  P8_6 location=M2 register=P8_6 offset=0x118 muxModes=GPIO8_6, UART3_RX_C, I2S1_SCLK_SLV_C, SPI1_SCLK_C, UT3_T0_C, LPCAM_PCLK_C, CAN1_TXD_B
  P8_7 location=N1 register=P8_7 offset=0x11C muxModes=GPIO8_7, UART3_TX_C, I2S1_WS_SLV_C, SPI1_SS0_C, UT3_T1_C, LPCAM_XVCLK_C, CAN1_STBY_B
  P15_0 location=N5 register=LPGPIO_CTRL_0 offset=0x0 muxModes=GPIOV_0, LPTMR0_CLK_IO
  P15_1 location=K6 register=LPGPIO_CTRL_1 offset=0x4 muxModes=GPIOV_1, LPTMR1_CLK_IO
  POR_N location=J10 register=NA offset=NA muxModes=POR_N
  VREF_P location=K13 register=NA offset=NA muxModes=VREF_P
  HFXO_P location=A3 register=NA offset=NA muxModes=HFXO_P
  HFXO_N location=A2 register=NA offset=NA muxModes=HFXO_N
  LFXO_P location=N9 register=NA offset=NA muxModes=LFXO_P
  LFXO_N location=M9 register=NA offset=NA muxModes=LFXO_N
  N.C. location=F1 register=NA offset=NA muxModes=Reserved
  N.C. location=C1 register=NA offset=NA muxModes=Reserved
  VSW location=M13 register=NA offset=NA muxModes=VSW
  VREG_AON location=K10 register=NA offset=NA muxModes=VREG_AON
  VREG_LP_1V8 location=N12 register=NA offset=NA muxModes=VREG_LP_1V8
  VREG_DIG_1V8 location=M10 register=NA offset=NA muxModes=VREG_DIG_1V8
  VREG_CORE_0V8 location=N11 register=NA offset=NA muxModes=VREG_CORE_0V8
  VREG_MIPI_1V8 location=N10 register=NA offset=NA muxModes=VREG_MIPI_1V8
  VSS_ANA location=M12 register=NA offset=NA muxModes=VSS_ANA
  VSS_BUCK location=N13 register=NA offset=NA muxModes=VSS_BUCK
  VDD_SX_0V8 location=A1 register=NA offset=NA muxModes=VDD_SX_0V8
  VDD_TRX_0V8 location=B1 register=NA offset=NA muxModes=VDD_TRX_0V8
  VDD_MAIN location=L12 register=NA offset=NA muxModes=VDD_MAIN
  VDD_BUCK location=L13 register=NA offset=NA muxModes=VDD_BUCK
  VDD_IO_FLEX location=K5 register=NA offset=NA muxModes=VDD_IO_FLEX
  VDD_MIPI_0V8 location=C13 register=NA offset=NA muxModes=VDD_MIPI_0V8
  MIPI_REXT location=D12 register=NA offset=NA muxModes=MIPI_REXT
  MIPIDSI_0_P location=A12 register=NA offset=NA muxModes=MIPIDSI_0_P
  MIPIDSI_0_N location=A13 register=NA offset=NA muxModes=MIPIDSI_0_N
  MIPIDSI_C_P location=B12 register=NA offset=NA muxModes=MIPIDSI_C_P
  MIPIDSI_C_N location=B13 register=NA offset=NA muxModes=MIPIDSI_C_N
  VSS location=D2 register=NA offset=NA muxModes=VSS
  VSS location=H7 register=NA offset=NA muxModes=VSS
  VSS location=B2 register=NA offset=NA muxModes=VSS
  VSS location=M11 register=NA offset=NA muxModes=VSS
  VSS location=G7 register=NA offset=NA muxModes=VSS
  VSS location=D1 register=NA offset=NA muxModes=VSS
  VSS location=G1 register=NA offset=NA muxModes=VSS
  VSS location=C12 register=NA offset=NA muxModes=VSS
  N.C. location=C2 register=NA offset=NA muxModes=N.C.
  N.C. location=K12 register=NA offset=NA muxModes=N.C.
  VDD_IO_1V8 location=F8 register=NA offset=NA muxModes=VDD_IO_1V8
  VDD_CORE_0V8 location=F7 register=NA offset=NA muxModes=VDD_CORE_0V8
  VDD_CORE_0V8 location=N3 register=NA offset=NA muxModes=VDD_CORE_0V8
  VDD_USB_3V3 location=A9 register=NA offset=NA muxModes=VDD_USB_3V3
  USB_REXT location=B9 register=NA offset=NA muxModes=USB_REXT
  USB_DP location=A8 register=NA offset=NA muxModes=USB_DP
  USB_DM location=B8 register=NA offset=NA muxModes=USB_DM
  USB_VBUS location=A7 register=NA offset=NA muxModes=USB_VBUS
  VDD_LNAPA_0V8 location=E1 register=NA offset=NA muxModes=VDD_LNAPA_0V8
clocks:
  CRC
    HCLK clkSource=SYST_HCLK clkDesc=CRC0 AHB slave interface clock
  IRQRTR
    CLKIN clkSource=SYST_REFCLK clkDesc=IRQRTR functional and interface clock
  EVTRTR2
    CLKIN clkSource=RTSS_HE_CLK clkDesc=EVTRTR2 functional and interface clock
  DMA2_SEC
    ACLK clkSource=RTSS_HE_CLK clkDesc=AXI master interface clock and DMAC functional clock
  DMA2_NS
    ACLK clkSource=RTSS_HE_CLK clkDesc=AXI master interface clock and DMAC functional clock
  LPTIMER0
    LPTIMER0_CLK clkSource=S32K_CLK, 128K_CLK, or LPTMR0_CLK_IO pin; Clock selection in the respective TIMER_CLKSEL[SELn] register bit clkDesc=LPTIMER0 timer clock
    PCLK clkSource=RTSS_HE_CLK clkDesc=LPTIMER0 APB bus clock
  LPTIMER1
    LPTIMER1_CLK clkSource=S32K_CLK, 128K_CLK, LPTMR1_CLK_IO pin, or LPTMR0_OUT; Clock selection in the respective TIMER_CLKSEL[SELn] register bit clkDesc=LPTIMER1 timer clock
    PCLK clkSource=RTSS_HE_CLK clkDesc=LPTIMER1 APB bus clock
  UTIMER0
    ACLK clkSource=SYST_ACLK clkDesc=Functional and AHB interface clock
  UTIMER1
    ACLK clkSource=SYST_ACLK clkDesc=Functional and AHB interface clock
  UTIMER2
    ACLK clkSource=SYST_ACLK clkDesc=Functional and AHB interface clock
  UTIMER3
    ACLK clkSource=SYST_ACLK clkDesc=Functional and AHB interface clock
  WDT_HE
    PCLK clkSource=RTSS_HE_CLK clkDesc=APB interface clock
    WDOGCLK1 clkSource=RTSS_HE_CLK clkDesc=WDT_HE functional clock
  LPRTC0
    LPRTC0_CLK clkSource=S32K_CLK; Clock source for S32K_CLK (LFRC or LFXO) can be selected by the clock select register bit: MISC_CTRL[SEL_32K] clkDesc=LPRTC0 counter clock
    PCLK clkSource=RTSS_HE_CLK clkDesc=LPRTC0 APB bus clock
  REFCLK_TMR
    CNT_CLK clkSource=SYST_REFCLK clkDesc=Functional clock for the counter and timers
    IF_CLK clkSource=SYST_REFCLK clkDesc=Interface clock for the registers
    SYNC_CLK clkSource=S32K_CLK clkDesc=Synchronization clock. See REFCLK_CNTSCR[ENSYNC].
  S32KCLK_TMR
    CNT_CLK clkSource=S32K_CLK clkDesc=Functional clock for the counter and timers
    IF_CLK clkSource=SYST_REFCLK clkDesc=Interface clock for the registers
  GPIO{n} (n=0..8)
    DBCLK clkSource=SYST_PCLK / DIV clkDesc=GPIO{n} debounce clock
    PCLK clkSource=SYST_PCLK clkDesc=GPIO{n} APB interface clock
    PCLK_INTR clkSource=SYST_PCLK clkDesc=GPIO{n} interrupt clock
  LPGPIO
    DBCLK clkSource=S32K_CLK; Clock selection is done via the SEL_FAST_APB_REG[SEL_FAST_APB_REG] register bit clkDesc=LPGPIO debounce clock
    PCLK clkSource=S32K_CLK; Clock selection is done via the SEL_FAST_APB_REG[SEL_FAST_APB_REG] register bit clkDesc=LPGPIO APB interface clock
    PCLK_INTR clkSource=S32K_CLK; Clock selection is done via the SEL_FAST_APB_REG[SEL_FAST_APB_REG] register bit clkDesc=LPGPIO interrupt clock
  CANFD0
    CANFD0_CLK clkSource=(HFOSC_CLK or PERIPH_CLK) / DIV (selection in CANFD_CTRL[CLK_SEL0] register bit); (divider can be controlled by the CANFD_CTRL[CKDIV0] field) clkDesc=CANF0D functional clock
    CANFD0_HOST_CLK clkSource=SYST_PCLK clkDesc=CANFD0 APB host interface clock
    CANFD0_TIMER_CLK clkSource=SYST_PCLK clkDesc=CANFD0 32-bit timer clock
  CANFD1
    CANFD1_CLK clkSource=(HFOSC_CLK or PERIPH_CLK) / DIV (selection in CANFD_CTRL[CLK_SEL1] register bit); (divider can be controlled by the CANFD_CTRL[CKDIV1] field) clkDesc=CANFD1 functional clock
    CANFD1_HOST_CLK clkSource=SYST_PCLK clkDesc=CANFD1 APB host interface clock
    CANFD1_TIMER_CLK clkSource=SYST_PCLK clkDesc=CANFD1 32-bit timer clock
  I2C0
    IC_CLK clkSource=SYST_PCLK clkDesc=I2C0 peripheral clock
    PCLK clkSource=SYST_PCLK clkDesc=I2C0 APB interface clock
  I2C1
    IC_CLK clkSource=SYST_PCLK clkDesc=I2C1 peripheral clock
    PCLK clkSource=SYST_PCLK clkDesc=I2C1 APB interface clock
  LPI2C
    PCLK clkSource=RTSS_HE_CLK clkDesc=LPI2C APB interface clock
  I2S0
    PCLK clkSource=SYST_PCLK clkDesc=APB slave interface clock
    SCLK clkSource=(76M8_CLK or AUDIO_PLL_CLK) / DIV; Clock selection in the I2Sn_CTRL[CLK_SEL] register bit. Clock divider can be controlled via the I2Sn_CTRL[CKDIV] field or it can be bypassed via the I2Sn_CTRL[DIV_BYPASS] field. clkDesc=Serial interface clock
    SCLK_N clkSource=(76M8_CLK or AUDIO_PLL_CLK) / DIV; Clock selection in the I2Sn_CTRL[CLK_SEL] register bit. Clock divider can be controlled via the I2Sn_CTRL[CKDIV] field or it can be bypassed via the I2Sn_CTRL[DIV_BYPASS] field. clkDesc=Inverted serial interface clock
  I2S1
    PCLK clkSource=SYST_PCLK clkDesc=APB slave interface clock
    SCLK clkSource=(76M8_CLK or AUDIO_PLL_CLK) / DIV; Clock selection in the I2Sn_CTRL[CLK_SEL] register bit. Clock divider can be controlled via the I2Sn_CTRL[CKDIV] field or it can be bypassed via the I2Sn_CTRL[DIV_BYPASS] field. clkDesc=Serial interface clock
    SCLK_N clkSource=(76M8_CLK or AUDIO_PLL_CLK) / DIV; Clock selection in the I2Sn_CTRL[CLK_SEL] register bit. Clock divider can be controlled via the I2Sn_CTRL[CKDIV] field or it can be bypassed via the I2Sn_CTRL[DIV_BYPASS] field. clkDesc=Inverted serial interface clock
  LPI2S
    PCLK clkSource=RTSS_HE_CLK clkDesc=APB slave interface clock
    SCLK clkSource=(76M8_CLK or AUDIO_PLL_CLK) / DIV; Clock selection in the HE_I2S_CTRL[CLK_SEL] register bit. Clock divider can be controlled via the HE_I2S_CTRL[CLK_DIVISOR] field or it can be bypassed via the HE_I2S_CTRL[DIV_BYPASS] field. clkDesc=Serial interface clock
    SCLK_N clkSource=(76M8_CLK or AUDIO_PLL_CLK) / DIV; Clock selection in the HE_I2S_CTRL[CLK_SEL] register bit. Clock divider can be controlled via the HE_I2S_CTRL[CLK_DIVISOR] field or it can be bypassed via the HE_I2S_CTRL[DIV_BYPASS] field. clkDesc=Inverted serial interface clock
  I3C
    CORE_CLK clkSource=SYST_ACLK clkDesc=I3C core interface clock
    DMA_CLK clkSource=SYST_ACLK clkDesc=I3C SDMA interface clock
    PCLK clkSource=SYST_ACLK clkDesc=I3C APB interface clock
  LPPDM
    LPPDM_CLK clkSource=76M8_CLK or AUDIO_PLL_CLK; Clock selection in the HE_CLK_ENA[PDM_CKSEL] register bit clkDesc=LPPDM functional clock
    PCLK clkSource=RTSS_HE_CLK clkDesc=LPPDM APB interface clock
  SPI0
    HCLK clkSource=SYST_HCLK clkDesc=SPI0 AHB interface clock
    SPI_0_CLK clkSource=SYST_HCLK clkDesc=SPI0 core clock is identical to AHB interface clock
  SPI1
    HCLK clkSource=SYST_HCLK clkDesc=SPI1 AHB interface clock
    SPI_1_CLK clkSource=SYST_HCLK clkDesc=SPI1 core clock is identical to AHB interface clock
  SPI2
    HCLK clkSource=SYST_HCLK clkDesc=SPI2 AHB interface clock
    SPI_2_CLK clkSource=SYST_HCLK clkDesc=SPI2 core clock is identical to AHB interface clock
  LPSPI0
    LPSPI_0_CLK clkSource=RTSS_HE_CLK clkDesc=LPSPI0 core clock
    PCLK clkSource=RTSS_HE_CLK clkDesc=LPSPI0 APB interface clock
  LPSPI1
    LPSPI_1_CLK clkSource=RTSS_HE_CLK clkDesc=LPSPI1 core clock
    PCLK clkSource=RTSS_HE_CLK clkDesc=LPSPI1 APB interface clock
  UART0
    PCLK clkSource=SYST_PCLK clkDesc=UART0 APB interface clock
    SCLK clkSource=HFOSC_CLK or SYST_PCLK; (selection in UART_CTRL[CLK_SEL] register field) clkDesc=UART0 serial interface clock
  UART1
    PCLK clkSource=SYST_PCLK clkDesc=UART1 APB interface clock
    SCLK clkSource=HFOSC_CLK or SYST_PCLK; (selection in UART_CTRL[CLK_SEL] register field) clkDesc=UART1 serial interface clock
  UART2
    PCLK clkSource=SYST_PCLK clkDesc=UART2 APB interface clock
    SCLK clkSource=HFOSC_CLK or SYST_PCLK; (selection in UART_CTRL[CLK_SEL] register field) clkDesc=UART2 serial interface clock
  UART3
    PCLK clkSource=SYST_PCLK clkDesc=UART3 APB interface clock
    SCLK clkSource=HFOSC_CLK or SYST_PCLK; (selection in UART_CTRL[CLK_SEL] register field) clkDesc=UART3 serial interface clock
  UART4
    PCLK clkSource=SYST_PCLK clkDesc=UART4 APB interface clock
    SCLK clkSource=HFOSC_CLK or SYST_PCLK; (selection in UART_CTRL[CLK_SEL] register field) clkDesc=UART4 serial interface clock
  UART5
    PCLK clkSource=SYST_PCLK clkDesc=UART5 APB interface clock
    SCLK clkSource=HFOSC_CLK or SYST_PCLK; (selection in UART_CTRL[CLK_SEL] register field) clkDesc=UART5 serial interface clock
  LPUART
    PCLK clkSource=RTSS_HE_CLK clkDesc=LPUART APB interface clock
  HCI_UART
    PCLK clkSource=SYST_PCLK clkDesc=HCI_UART APB interface clock
    SCLK clkSource=RTSS_HE_CLK clkDesc=HCI_UART serial interface clock
  AHI_UART
    PCLK clkSource=SYST_PCLK clkDesc=AHI_UART APB interface clock
    SCLK clkSource=RTSS_HE_CLK clkDesc=AHI_UART serial interface clock
  USB
    BUS_CLK clkSource=SYST_HCLK clkDesc=AHB interface clock
    REF_CLK clkSource=10M_CLK clkDesc=REF_CLK generates the ITP counter when the UTMI PHY is in the suspended state (10 MHz)
  USB2PHY
    USB2_REFCLOCK clkSource=USB_CLK clkDesc=PHY PLL reference clock (20 MHz)
  SDMMC
    ACLK clkSource=SYST_HCLK clkDesc=AXI master interface clock
    BCLK clkSource=80M_CLK clkDesc=SDMMC core base clock
    CCLK_RX clkSource=80M_CLK/Div clkDesc=SDMMC card receive clock
    CCLK_TX clkSource=80M_CLK/Div clkDesc=SDMMC card transmit clock
    HCLK clkSource=SYST_HCLK clkDesc=AHB slave interface clock
    TMCLK clkSource=10M_CLK clkDesc=SDMMC timer clock
  LPCPI
    ACLK clkSource=RTSS_HE_CLK clkDesc=LPCPI AXI interface clock
    PCLK clkSource=RTSS_HE_CLK clkDesc=LPCPI APB interface clock
    PIXEL_CLK clkSource=LPCAM_PCLK pin or LPCAM_PCLK inverted pin clkDesc=LPCPI pixel clock
  CDC
    ACLK clkSource=SYST_HCLK clkDesc=CDC AXI master interface clock
    PCLK clkSource=SYST_PCLK clkDesc=CDC APB slave interface clock
    PIXEL_CLK clkSource=(SYST_ACLK or PLL_CLK1) / Div; (source selection and divider value can be configured in the CDC200_PIXCLK_CTRL[CLK_SEL] and [CLK_DIVISOR] register fields) clkDesc=CDC pixel data clock
  DSI
    LANEBYTECLK clkSource=D-PHY TX clkDesc=DSI lane byte clock
    PCLK clkSource=SYST_PCLK clkDesc=DSI APB slave interface clock
    RXCLKESC clkSource=D-PHY TX clkDesc=DSI RX escape clock
  D-PHYTX
    CFG_CLK clkSource=80M_CLK/4 clkDesc=D-PHY TX configuration clock (20 MHz)
    CLKEXT clkSource=PLL_CLK1 clkDesc=D-PHY TX PLL bypass clock (160 MHz)
    CLKIN clkSource=HFOSC_CLK clkDesc=D-PHY TX PLL reference clock (38.4 MHz)
    TXCLKESC clkSource=DSI clkDesc=DSI escape mode transmit clock
  ADC120
    ADC_CLK clkSource=PERIPH_CLK clkDesc=Functional clock
    PCLK clkSource=SYST_PCLK clkDesc=APB interface clock
  ADC121
    ADC_CLK clkSource=PERIPH_CLK clkDesc=Functional clock
    PCLK clkSource=SYST_PCLK clkDesc=APB interface clock
  ADC24
    ADC_CLK clkSource=PERIPH_CLK clkDesc=Functional clock
    PCLK clkSource=SYST_PCLK clkDesc=APB interface clock
  CMP0
    PCLK clkSource=SYST_PCLK clkDesc=Register interface clock
  CMP1
    PCLK clkSource=SYST_PCLK clkDesc=Register interface clock
  LPCMP
    CLK32K clkSource=LFRC,LFXO clkDesc=LPCMP 32-kHz functional clock
  M55-HE
    CLKIN clkSource=RTSS_HE_CLK clkDesc=M55-HE functional and interface clock
  GPU2D
    CLK clkSource=SYST_ACLK clkDesc=Functional and AXI interface clock
  MHU_SECPU_M55HE_0_RX
    CLK clkSource=RTSS_HE_CLK clkDesc=Interface and functional clock
  MHU_M55HE_SECPU_0_TX
    CLK clkSource=RTSS_HE_CLK clkDesc=Interface and functional clock
  MHU_SECPU_M55HE_1_RX
    CLK clkSource=RTSS_HE_CLK clkDesc=Interface and functional clock
  MHU_M55HE_SECPU_1_TX
    CLK clkSource=RTSS_HE_CLK clkDesc=Interface and functional clock
irqs:
  FCTLR
    FW_IRQ cpuLine=IRQRTR_SII_0 cpuLineNum=0 type=Level irqDesc=FCTLR interrupt request
  GPIO0
    GPIO0_IRQ{n} cpuLine=IRQRTR_SII_{n+115},M55HE_IRQS_{n+179} cpuLineNum={n+115},{n+179} type=Level irqDesc=GPIO0 interrupt request {n} (n=0..7)
  GPIO1
    GPIO1_IRQ{n} cpuLine=IRQRTR_SII_{n+123},M55HE_IRQS_{n+187} cpuLineNum={n+123},{n+187} type=Level irqDesc=GPIO1 interrupt request {n} (n=0..7)
  GPIO2
    GPIO2_IRQ{n} cpuLine=IRQRTR_SII_{n+131},M55HE_IRQS_{n+195} cpuLineNum={n+131},{n+195} type=Level irqDesc=GPIO2 interrupt request {n} (n=0..7)
  GPIO3
    GPIO3_IRQ{n} cpuLine=IRQRTR_SII_{n+139},M55HE_IRQS_{n+203} cpuLineNum={n+139},{n+203} type=Level irqDesc=GPIO3 interrupt request {n} (n=0..7)
  GPIO4
    GPIO4_IRQ{n} cpuLine=IRQRTR_SII_{n+147},M55HE_IRQS_{n+211} cpuLineNum={n+147},{n+211} type=Level irqDesc=GPIO4 interrupt request {n} (n=0..7)
  GPIO5
    GPIO5_IRQ{n} cpuLine=IRQRTR_SII_{n+155},M55HE_IRQS_{n+219} cpuLineNum={n+155},{n+219} type=Level irqDesc=GPIO5 interrupt request {n} (n=0..7)
  GPIO6
    GPIO6_IRQ{n} cpuLine=IRQRTR_SII_{n+163},M55HE_IRQS_{n+227} cpuLineNum={n+163},{n+227} type=Level irqDesc=GPIO6 interrupt request {n} (n=0..7)
  GPIO7
    GPIO7_IRQ{n} cpuLine=IRQRTR_SII_{n+171},M55HE_IRQS_{n+235} cpuLineNum={n+171},{n+235} type=Level irqDesc=GPIO7 interrupt request {n} (n=0..7)
  GPIO8
    GPIO8_IRQ{n} cpuLine=IRQRTR_SII_{n+179},M55HE_IRQS_{n+243} cpuLineNum={n+179},{n+243} type=Level irqDesc=GPIO8 interrupt request {n} (n=0..7)
  LPRTC0
    LPRTC0_IRQ cpuLine=IRQRTR_SII_286,M55HE_IRQS_350,M55HE_IRQS_58 cpuLineNum=286,350,58 type=Level irqDesc=LPRTC0 interrupt request
  LPRTC1
    LPRTC1_IRQ cpuLine=IRQRTR_SII_287,M55HE_IRQS_351,M55HE_IRQS_59 cpuLineNum=287,351,59 type=Level
  LPTIMER0
    LPTIMER0_IRQ cpuLine=IRQRTR_SII_282,M55HE_IRQS_346,M55HE_IRQS_60 cpuLineNum=282,346,60 type=Level irqDesc=LPTIMER0 interrupt request
  LPTIMER1
    LPTIMER1_IRQ cpuLine=IRQRTR_SII_283,M55HE_IRQS_347,M55HE_IRQS_61 cpuLineNum=283,347,61 type=Level irqDesc=LPTIMER1 interrupt request
  LPGPIO
    LPGPIO_COMB_IRQ cpuLine=M55HE_IRQS_57 cpuLineNum=57 type=Level irqDesc=LPGPIO combined interrupt request
    LPGPIO_IRQ0 cpuLine=IRQRTR_SII_107,M55HE_IRQS_171 cpuLineNum=107,171 type=Level irqDesc=LPGPIO interrupt request 0
    LPGPIO_IRQ1 cpuLine=IRQRTR_SII_108,M55HE_IRQS_172 cpuLineNum=108,172 type=Level irqDesc=LPGPIO interrupt request 1
  LPI2S
    LPI2S_IRQ cpuLine=M55HE_IRQS_48 cpuLineNum=48 type=Level irqDesc=LPI2S interrupt request
  LPPDM
    LPPDM_IRQ cpuLine=M55HE_IRQS_49 cpuLineNum=49 irqDesc=LPPDM combined (OR-ed) interrupt of following requests : Warning interrupt request (WARN_IRQ) Error interrupt request (ERROR_IRQ) Audio peak detection interrupt request (AUDIO_DET_IRQ) Upon interrupt assertion, the LPPDM interrupt status registers should be read to identify the source of the interrupt.
  LPUART
    LPUART_IRQ cpuLine=M55HE_IRQS_45 cpuLineNum=45 type=Level irqDesc=LPUART interrupt request
  LPI2C
    LPI2C_IRQ cpuLine=M55HE_IRQS_47 cpuLineNum=47 type=Level irqDesc=LPI2C interrupt request
  LPCMP
    LPCMP_IRQ cpuLine=M55HE_IRQS_56 cpuLineNum=56 type=Level irqDesc=Comparator output changed
  HCI_UART
    HCI_UART_IRQ cpuLine=M55HE_IRQS_50 cpuLineNum=50 type=Level irqDesc=HCI_UART interrupt request
  AHI_UART
    AHI_UART_IRQ cpuLine=M55HE_IRQS_51 cpuLineNum=51 type=Level irqDesc=AHI_UART interrupt request
  LPCPI
    LPCAM_IRQ cpuLine=M55HE_IRQS_54 cpuLineNum=54 type=Edge irqDesc=LPCPI interrupt
  DSI
    DSI_IRQ cpuLine=IRQRTR_SII_279,M55HE_IRQS_343 cpuLineNum=279,343 type=Level irqDesc=DSI error interrupt
  CDC
    CDC_BUS_ERROR0_IRQ cpuLine=IRQRTR_SII_275,M55HE_IRQS_339 cpuLineNum=275,339 type=Level irqDesc=CDC bus error interrupt
    CDC_FIFO_UNDERRUN0_IRQ cpuLine=IRQRTR_SII_273,M55HE_IRQS_337 cpuLineNum=273,337 type=Level irqDesc=CDC layer FIFO underrun interrupt
    CDC_FIFO_WARNING0_IRQ cpuLine=IRQRTR_SII_271,M55HE_IRQS_335 cpuLineNum=271,335 type=Level irqDesc=CDC FIFO underrun warning interrupt
    CDC_REG_RELOAD0_IRQ cpuLine=IRQRTR_SII_277,M55HE_IRQS_341 cpuLineNum=277,341 type=Level irqDesc=CDC register reload interrupt
    CDC_SCANLINE0_IRQ cpuLine=IRQRTR_SII_269,M55HE_IRQS_333 cpuLineNum=269,333 type=Level irqDesc=CDC line interrupt
  GPU2D
    GPU2D_IRQ cpuLine=IRQRTR_SII_268,M55HE_IRQS_332 cpuLineNum=268,332 type=Level irqDesc=GPU2D aggregated interrupt request
  ADC120
    ADC120_CMPA_IRQ cpuLine=M55HE_IRQS_157,IRQRTR_SII_93 cpuLineNum=157,93 type=Level irqDesc=Comparator A interrupt
    ADC120_CMPB_IRQ cpuLine=M55HE_IRQS_160,IRQRTR_SII_96 cpuLineNum=160,96 type=Level irqDesc=Comparator B interrupt
    ADC120_DONE0_IRQ cpuLine=M55HE_IRQS_151,IRQRTR_SII_87 cpuLineNum=151,87 type=Level irqDesc=Averaged sample ready
    ADC120_DONE1_IRQ cpuLine=M55HE_IRQS_154,IRQRTR_SII_90 cpuLineNum=154,90 type=Level irqDesc=All samples taken
  ADC121
    ADC121_CMPA_IRQ cpuLine=M55HE_IRQS_158,IRQRTR_SII_94 cpuLineNum=158,94 type=Level irqDesc=Comparator A interrupt
    ADC121_CMPB_IRQ cpuLine=M55HE_IRQS_161,IRQRTR_SII_97 cpuLineNum=161,97 type=Level irqDesc=Comparator B interrupt
    ADC121_DONE0_IRQ cpuLine=M55HE_IRQS_152,IRQRTR_SII_88 cpuLineNum=152,88 type=Level irqDesc=Averaged sample ready
    ADC121_DONE1_IRQ cpuLine=M55HE_IRQS_155,IRQRTR_SII_91 cpuLineNum=155,91 type=Level irqDesc=All samples taken
  ADC24
    ADC24_CMPA_IRQ cpuLine=IRQRTR_SII_101,M55HE_IRQS_165 cpuLineNum=101,165 type=Level irqDesc=Comparator A interrupt
    ADC24_CMPB_IRQ cpuLine=IRQRTR_SII_102,M55HE_IRQS_166 cpuLineNum=102,166 type=Level irqDesc=Comparator B interrupt
    ADC24_DONE0_IRQ cpuLine=M55HE_IRQS_163,IRQRTR_SII_99 cpuLineNum=163,99 type=Level irqDesc=Averaged sample ready
    ADC24_DONE1_IRQ cpuLine=IRQRTR_SII_100,M55HE_IRQS_164 cpuLineNum=100,164 type=Level irqDesc=All samples taken
  CMP0
    CMP0_IRQ cpuLine=IRQRTR_SII_103,M55HE_IRQS_167 cpuLineNum=103,167 type=Level irqDesc=Comparator result changed
  CMP1
    CMP1_IRQ cpuLine=IRQRTR_SII_104,M55HE_IRQS_168 cpuLineNum=104,168 type=Level irqDesc=Comparator result changed
  CANFD0
    CANFD0_IRQ cpuLine=M55HE_IRQS_104,IRQRTR_SII_40 cpuLineNum=104,40 type=Level irqDesc=CANFD0 Interrupt request
  CANFD1
    CANFD1_IRQ cpuLine=M55HE_IRQS_105,IRQRTR_SII_41 cpuLineNum=105,41 type=Level irqDesc=CANFD1 Interrupt request
  I2C0
    I2C0_IRQ cpuLine=M55HE_IRQS_132,IRQRTR_SII_68 cpuLineNum=132,68 type=Level irqDesc=I2C0 interrupt request
  I2C1
    I2C1_IRQ cpuLine=M55HE_IRQS_133,IRQRTR_SII_69 cpuLineNum=133,69 type=Level irqDesc=I2C1 interrupt request
  I2S0
    I2S0_IRQ cpuLine=M55HE_IRQS_141,IRQRTR_SII_77 cpuLineNum=141,77 type=Level irqDesc=I2S0 interrupt request
  I2S1
    I2S1_IRQ cpuLine=M55HE_IRQS_142,IRQRTR_SII_78 cpuLineNum=142,78 type=Level irqDesc=I2S1 interrupt request
  I3C
    I3C_IRQ cpuLine=M55HE_IRQS_136,IRQRTR_SII_72 cpuLineNum=136,72 type=Level irqDesc=I3C interrupt request
  SPI0
    SPI0_IRQ cpuLine=M55HE_IRQS_137,IRQRTR_SII_73 cpuLineNum=137,73 type=Level irqDesc=SPI0 interrupt request
  SPI1
    SPI1_IRQ cpuLine=M55HE_IRQS_138,IRQRTR_SII_74 cpuLineNum=138,74 type=Level irqDesc=SPI1 interrupt request
  SPI2
    SPI2_IRQ cpuLine=M55HE_IRQS_139,IRQRTR_SII_75 cpuLineNum=139,75 type=Level irqDesc=SPI2 interrupt request
  UART0
    UART0_IRQ cpuLine=M55HE_IRQS_124,IRQRTR_SII_60 cpuLineNum=124,60 type=Level irqDesc=UART0 interrupt request
  UART1
    UART1_IRQ cpuLine=M55HE_IRQS_125,IRQRTR_SII_61 cpuLineNum=125,61 type=Level irqDesc=UART1 interrupt request
  UART2
    UART2_IRQ cpuLine=M55HE_IRQS_126,IRQRTR_SII_62 cpuLineNum=126,62 type=Level irqDesc=UART2 interrupt request
  UART3
    UART3_IRQ cpuLine=M55HE_IRQS_127,IRQRTR_SII_63 cpuLineNum=127,63 type=Level irqDesc=UART3 interrupt request
  UART4
    UART4_IRQ cpuLine=M55HE_IRQS_128,IRQRTR_SII_64 cpuLineNum=128,64 type=Level irqDesc=UART4 interrupt request
  UART5
    UART5_IRQ cpuLine=M55HE_IRQS_129,IRQRTR_SII_65 cpuLineNum=129,65 type=Level irqDesc=UART5 interrupt request
  USB
    USB_IRQ cpuLine=M55HE_IRQS_101,IRQRTR_SII_37 cpuLineNum=101,37 type=Level irqDesc=USB interrupt
  UTIMER0
    UTIMER_IRQ{n} cpuLine=IRQRTR_SII_{n+313},M55HE_IRQS_{n+377} cpuLineNum={n+313},{n+377} type=Level irqDesc=Channel 0, interrupt request {n} (n=0..7)
  UTIMER1
    UTIMER_IRQ{n} cpuLine=IRQRTR_SII_{n+313},M55HE_IRQS_{n+377} cpuLineNum={n+313},{n+377} type=Level irqDesc=Channel 1, interrupt request {n} (n=8..15)
  UTIMER2
    UTIMER_IRQ{n} cpuLine=IRQRTR_SII_{n+313},M55HE_IRQS_{n+377} cpuLineNum={n+313},{n+377} type=Level irqDesc=Channel 2, interrupt request {n} (n=16..23)
  UTIMER3
    UTIMER_IRQ{n} cpuLine=IRQRTR_SII_{n+313},M55HE_IRQS_{n+377} cpuLineNum={n+313},{n+377} type=Level irqDesc=Channel 3, interrupt request {n} (n=24..31)
  REFCLK_CNTBase0
    REFCLK_CNTBASE0_IRQ cpuLine=IRQRTR_SII_3,M55HE_IRQS_67 cpuLineNum=3,67 type=Level irqDesc=Interrupt generated when the timer condition is met. See registers CNTP_TVAL and CNTP_CTL for the timer condition definition.
  REFCLK_CNTBase1
    REFCLK_CNTBASE1_IRQ cpuLine=IRQRTR_SII_4,M55HE_IRQS_68 cpuLineNum=4,68 type=Level irqDesc=Interrupt generated when the timer condition is met. See registers CNTP_TVAL and CNTP_CTL for the timer condition definition.
  REFCLK_CNTBase2
    REFCLK_CNTBASE2_IRQ cpuLine=IRQRTR_SII_5,M55HE_IRQS_69 cpuLineNum=5,69 type=Level irqDesc=Interrupt generated when the timer condition is met. See registers CNTP_TVAL and CNTP_CTL for the timer condition definition.
  REFCLK_CNTBase3
    REFCLK_CNTBASE3_IRQ cpuLine=IRQRTR_SII_6,M55HE_IRQS_70 cpuLineNum=6,70 type=Level irqDesc=Interrupt generated when the timer condition is met. See registers CNTP_TVAL and CNTP_CTL for the timer condition definition.
  S32K_CNTBase0
    S32K_CNTBASE0_IRQ cpuLine=IRQRTR_SII_7,M55HE_IRQS_71 cpuLineNum=7,71 type=Level irqDesc=Interrupt generated when the timer condition is met. See registers CNTP_TVAL and CNTP_CTL for the timer condition definition.
  S32K_CNTBase1
    S32K_CNTBASE1_IRQ cpuLine=M55HE_IRQS_72,IRQRTR_SII_8 cpuLineNum=72,8 type=Level irqDesc=Interrupt generated when the timer condition is met. See registers CNTP_TVAL and CNTP_CTL for the timer condition definition.
  SDMMC
    SDMMC_IRQ cpuLine=M55HE_IRQS_102,IRQRTR_SII_38 cpuLineNum=102,38 type=Level irqDesc=SDMMC Interrupt request
    SDMMC_WAKEUP_IRQ cpuLine=M55HE_IRQS_103,IRQRTR_SII_39 cpuLineNum=103,39 type=Level irqDesc=SDMMC Wakeup event interrupt request
  OSPI0
    OSPI_IRQ cpuLine=IRQRTR_SII_32,M55HE_IRQS_96 cpuLineNum=32,96 type=Level
  AES0
    AES_IRQ cpuLine=IRQRTR_SII_34,M55HE_IRQS_98 cpuLineNum=34,98 type=Level
  DMA2_SEC
    DMA2_IRQ{n} cpuLine=M55HE_IRQS_{n} cpuLineNum={n} type=Level irqDesc=Interrupt request {n}. One per DMA request interface (32 in total). (n=0..31)
    DMA2_IRQ_ABORT cpuLine=M55HE_IRQS_32 cpuLineNum=32 type=Level irqDesc=DMAC aborted execution of a program thread.
  DMA2_NS
    DMA2_IRQ{n} cpuLine=M55HE_IRQS_{n} cpuLineNum={n} type=Level irqDesc=Interrupt request {n}. One per DMA request interface (32 in total). (n=0..31)
    DMA2_IRQ_ABORT cpuLine=M55HE_IRQS_32 cpuLineNum=32 type=Level irqDesc=DMAC aborted execution of a program thread.
  REFCLK_CNTBase0
    REFCLK_CNTBASE0_IRQ cpuLine=IRQRTR_SII_3,M55HE_IRQS_67 cpuLineNum=3,67 type=Level irqDesc=Interrupt generated when the timer condition is met. See registers CNTP_TVAL and CNTP_CTL for the timer condition definition.
  REFCLK_CNTBase1
    REFCLK_CNTBASE1_IRQ cpuLine=IRQRTR_SII_4,M55HE_IRQS_68 cpuLineNum=4,68 type=Level irqDesc=Interrupt generated when the timer condition is met. See registers CNTP_TVAL and CNTP_CTL for the timer condition definition.
  REFCLK_CNTBase2
    REFCLK_CNTBASE2_IRQ cpuLine=IRQRTR_SII_5,M55HE_IRQS_69 cpuLineNum=5,69 type=Level irqDesc=Interrupt generated when the timer condition is met. See registers CNTP_TVAL and CNTP_CTL for the timer condition definition.
  REFCLK_CNTBase3
    REFCLK_CNTBASE3_IRQ cpuLine=IRQRTR_SII_6,M55HE_IRQS_70 cpuLineNum=6,70 type=Level irqDesc=Interrupt generated when the timer condition is met. See registers CNTP_TVAL and CNTP_CTL for the timer condition definition.
  S32K_CNTBase0
    S32K_CNTBASE0_IRQ cpuLine=IRQRTR_SII_7,M55HE_IRQS_71 cpuLineNum=7,71 type=Level irqDesc=Interrupt generated when the timer condition is met. See registers CNTP_TVAL and CNTP_CTL for the timer condition definition.
  S32K_CNTBase1
    S32K_CNTBASE1_IRQ cpuLine=IRQRTR_SII_8,M55HE_IRQS_72 cpuLineNum=8,72 type=Level irqDesc=Interrupt generated when the timer condition is met. See registers CNTP_TVAL and CNTP_CTL for the timer condition definition.
  BOD
    BOD_IRQ cpuLine=IRQRTR_SII_36,M55HE_IRQS_100 cpuLineNum=36,100 type=Level irqDesc=Voltage below threshold
  MHU_SECPU_M55HE_0_RX
    MHU_SECPU_M55HE_0_RX_IRQ cpuLine=M55HE_IRQS_37 cpuLineNum=37 type=Level irqDesc=Interrupt
  MHU_M55HE_SECPU_0_TX
    MHU_M55HE_SECPU_0_TX_IRQ cpuLine=M55HE_IRQS_38 cpuLineNum=38 type=Level irqDesc=Interrupt
  MHU_SECPU_M55HE_1_RX
    MHU_SECPU_M55HE_1_RX_IRQ cpuLine=M55HE_IRQS_39 cpuLineNum=39 type=Level irqDesc=Interrupt
  MHU_M55HE_SECPU_1_TX
    MHU_M55HE_SECPU_1_TX_IRQ cpuLine=M55HE_IRQS_40 cpuLineNum=40 type=Level irqDesc=Interrupt
dreqs:
  LPTIMER0
    LPTIMER0_DMA_REQ dmaLine=DMA2_REQ_0 dreqDesc=Request to DMA2 controller
  LPTIMER1
    LPTIMER1_DMA_REQ dmaLine=DMA2_REQ_1 dreqDesc=Request to DMA2 controller
  UTIMER0
    UT0_T0_DMA_REQ dmaLine=DMA2_REQ_0 dreqDesc=UT0_T0 DMA request
    UT0_T1_DMA_REQ dmaLine=DMA2_REQ_1 dreqDesc=UT0_T1 DMA request
  UTIMER1
    UT1_T0_DMA_REQ dmaLine=DMA2_REQ_2 dreqDesc=UT1_T0 DMA request
    UT1_T1_DMA_REQ dmaLine=DMA2_REQ_3 dreqDesc=UT1_T1 DMA request
  UTIMER2
    UT2_T0_DMA_REQ dmaLine=DMA2_REQ_4 dreqDesc=UT2_T0 DMA request
    UT2_T1_DMA_REQ dmaLine=DMA2_REQ_5 dreqDesc=UT2_T1 DMA request
  UTIMER3
    UT3_T0_DMA_REQ dmaLine=DMA2_REQ_6 dreqDesc=UT3_T0 DMA request
    UT3_T1_DMA_REQ dmaLine=DMA2_REQ_7 dreqDesc=UT3_T1 DMA request
  GPIO1
    GPIO1_{n}_DMA_REQ dmaLine=DMA2_REQ_{n+24} dreqDesc=GPIO1 pin {n} request (n=0..7)
  GPIO3
    GPIO3_{n}_DMA_REQ dmaLine=DMA2_REQ_{n} dreqDesc=GPIO3 pin {n} request (n=0..7)
  GPIO4
    GPIO4_{n}_DMA_REQ dmaLine=DMA2_REQ_{n+8} dreqDesc=GPIO4 pin {n} request (n=0..7)
  GPIO7
    GPIO7_{n}_DMA_REQ dmaLine=DMA2_REQ_{n+16} dreqDesc=GPIO7 pin {n} request (n=0..7)
  LPGPIO
    LPGPIO_0_DMA_REQ dmaLine=DMA2_REQ_30 dreqDesc=LPGPIO pin 0 request
    LPGPIO_1_DMA_REQ dmaLine=DMA2_REQ_31 dreqDesc=LPGPIO pin 1 request
  CANFD0
    CANFD0_DMA_RX_REQ dmaLine=DMA2_REQ_22 dreqDesc=CANFD0 Receive DMA request
    CANFD0_DMA_TX_REQ dmaLine=DMA2_REQ_23 dreqDesc=CANFD0 Transmit DMA request
  CANFD1
    CANFD1_DMA_RX_REQ dmaLine=DMA2_REQ_4 dreqDesc=CANFD1 Receive DMA request
    CANFD1_DMA_TX_REQ dmaLine=DMA2_REQ_5 dreqDesc=CANFD1 Transmit DMA request
  I2C0
    I2C0_DMA_RX_REQ dmaLine=DMA2_REQ_24 dreqDesc=I2C0 receive request
    I2C0_DMA_TX_REQ dmaLine=DMA2_REQ_28 dreqDesc=I2C0 transmit request
  I2C1
    I2C1_DMA_RX_REQ dmaLine=DMA2_REQ_25 dreqDesc=I2C1 receive request
    I2C1_DMA_TX_REQ dmaLine=DMA2_REQ_29 dreqDesc=I2C1 transmit request
  I2S0
    I2S0_DMA_RX_REQ dmaLine=DMA2_REQ_24 dreqDesc=I2S0 Receive DMA request
    I2S0_DMA_TX_REQ dmaLine=DMA2_REQ_28 dreqDesc=I2S0 Transmit DMA request
    I2S0_DMA_WS_REQ dmaLine=DMA2_REQ_2 dreqDesc=I2S0 Word Select DMA request
  I2S1
    I2S1_DMA_RX_REQ dmaLine=DMA2_REQ_25 dreqDesc=I2S1 Receive DMA request
    I2S1_DMA_TX_REQ dmaLine=DMA2_REQ_29 dreqDesc=I2S1 Transmit DMA request
    I2S1_DMA_WS_REQ dmaLine=DMA2_REQ_3 dreqDesc=I2S1 Word Select DMA request
  LPI2S
    LPI2S_DMA_RX_REQ dmaLine=DMA2_REQ_14 dreqDesc=LPI2S Receive DMA request
    LPI2S_DMA_TX_REQ dmaLine=DMA2_REQ_15 dreqDesc=LPI2S Transmit DMA request
    LPI2S_DMA_WS_REQ dmaLine=DMA2_REQ_6 dreqDesc=LPI2S Word Select DMA request
  I3C
    I3C_DMA_RX_REQ dmaLine=DMA2_REQ_20 dreqDesc=I3C receive request
    I3C_DMA_TX_REQ dmaLine=DMA2_REQ_21 dreqDesc=I3C transmit request
  LPPDM
    LPPDM_DMA_REQ dmaLine=DMA2_REQ_30 dreqDesc=LPPDM DMA request
  SPI0
    SPI0_DMA_RX_REQ dmaLine=DMA2_REQ_16 dreqDesc=SPI0 receive DMA request
    SPI0_DMA_TX_REQ dmaLine=DMA2_REQ_20 dreqDesc=SPI0 transmit DMA request
  SPI1
    SPI1_DMA_RX_REQ dmaLine=DMA2_REQ_17 dreqDesc=SPI1 receive DMA request
    SPI1_DMA_TX_REQ dmaLine=DMA2_REQ_21 dreqDesc=SPI1 transmit DMA request
  SPI2
    SPI2_DMA_RX_REQ dmaLine=DMA2_REQ_18 dreqDesc=SPI2 receive DMA request
    SPI2_DMA_TX_REQ dmaLine=DMA2_REQ_22 dreqDesc=SPI2 transmit DMA request
  UART0
    UART0_DMA_RX_REQ dmaLine=DMA2_REQ_8 dreqDesc=UART0 receive request
    UART0_DMA_TX_REQ dmaLine=DMA2_REQ_16 dreqDesc=UART0 transmit request
  UART1
    UART1_DMA_RX_REQ dmaLine=DMA2_REQ_9 dreqDesc=UART1 receive request
    UART1_DMA_TX_REQ dmaLine=DMA2_REQ_17 dreqDesc=UART1 transmit request
  UART2
    UART2_DMA_RX_REQ dmaLine=DMA2_REQ_10 dreqDesc=UART2 receive request
    UART2_DMA_TX_REQ dmaLine=DMA2_REQ_18 dreqDesc=UART2 transmit request
  UART3
    UART3_DMA_RX_REQ dmaLine=DMA2_REQ_11 dreqDesc=UART3 receive request
    UART3_DMA_TX_REQ dmaLine=DMA2_REQ_19 dreqDesc=UART3 transmit request
  UART4
    UART4_DMA_RX_REQ dmaLine=DMA2_REQ_12 dreqDesc=UART4 receive request
    UART4_DMA_TX_REQ dmaLine=DMA2_REQ_20 dreqDesc=UART4 transmit request
  UART5
    UART5_DMA_RX_REQ dmaLine=DMA2_REQ_13 dreqDesc=UART5 receive request
    UART5_DMA_TX_REQ dmaLine=DMA2_REQ_21 dreqDesc=UART5 transmit request
  LPUART
    LPUART_DMA_RX_REQ dmaLine=DMA2_REQ_8 dreqDesc=LPUART receive request
    LPUART_DMA_TX_REQ dmaLine=DMA2_REQ_9 dreqDesc=LPUART transmit request
  HCI_UART
    HCI_UART_DMA_RX_REQ dmaLine=DMA2_REQ_26 dreqDesc=HCI_UART receive request
    HCI_UART_DMA_TX_REQ dmaLine=DMA2_REQ_27 dreqDesc=HCI_UART transmit request
  AHI_UART
    AHI_UART_DMA_RX_REQ dmaLine=DMA2_REQ_2 dreqDesc=AHI_UART receive request
    AHI_UART_DMA_TX_REQ dmaLine=DMA2_REQ_3 dreqDesc=AHI_UART transmit request
  LPCPI
    LPCAM_VSYNC_DMA_REQ dmaLine=DMA2_REQ_26 dreqDesc=LPCPI VSYNC DMA request
    LPCAM_HSYNC_DMA_REQ dmaLine=DMA2_REQ_27 dreqDesc=LPCPI HSYNC DMA request
  CDC
    CDC_VSYNC_DMA_REQ dmaLine=DMA2_REQ_28 dreqDesc=CDC VSYNC DMA request
    CDC_HSYNC_DMA_REQ dmaLine=DMA2_REQ_29 dreqDesc=CDC HSYNC DMA request
  ADC120
    ADC120_DONE0_DMA_REQ dmaLine=DMA2_REQ_4,UT_EVENT_4 dreqDesc=Averaged sample ready
  ADC121
    ADC121_DONE0_DMA_REQ dmaLine=DMA2_REQ_5,UT_EVENT_5 dreqDesc=Averaged sample ready
  ADC24
    ADC24_DONE0_DMA_REQ dmaLine=DMA2_REQ_10,UT_EVENT_10 dreqDesc=Averaged sample ready
    ADC24_DONE1_DMA_REQ dmaLine=DMA2_REQ_11,UT_EVENT_11 dreqDesc=All samples taken
  CMP0
    CMP0_DMA_REQ dmaLine=DMA2_REQ_0,UT_EVENT_0 dreqDesc=Comparator result changed
  CMP1
    CMP1_DMA_REQ dmaLine=DMA2_REQ_1,UT_EVENT_1 dreqDesc=Comparator result changed
  LPCMP
    LPCMP_DMA_REQ dmaLine=DMA2_REQ_6 dreqDesc=Comparator output changed
  BOD
    BOD_DMA_REQ dmaLine=DMA2_REQ_7,UT_EVENT_7 dreqDesc=Voltage below threshold

## Licence text in the file
THIS SOFTWARE IS PROVIDED "AS IS". NO WARRANTIES, WHETHER EXPRESS, IMPLIED. OR STATUTORY, INCLUDING, BUT NOT LIMITED TO, IMPLIED WARRANTIES OF. MERCHANTABILITY AND FITNESS FOR A PARTICULAR PURPOSE APPLY TO THIS SOFTWARE. ALIF SHALL NOT, IN ANY CIRCUMSTANCES, BE LIABLE FOR SPECIAL, INCIDENTAL, OR. CONSEQUENTIAL DAMAGES, FOR ANY REASON WHATSOEVER.
